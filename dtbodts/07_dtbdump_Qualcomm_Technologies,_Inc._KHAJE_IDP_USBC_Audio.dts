/dts-v1/;

/ {
	compatible = "qcom,khaje-idp", "qcom,khaje", "qcom,idp";
	model = "Qualcomm Technologies, Inc. KHAJE IDP USBC Audio";
	qcom,board-id = <0x1010022 0x0>;
	qcom,msm-id = <0x24a 0x10000>;
	qcom,pmic-id = <0x2d 0x2e 0x0 0x0>;

	__fixups__ {
		CPU0 = "/fragment@0/__overlay__/pm6125-tz/cooling-maps/trip0_cpu0:cooling-device:0";
		CPU4 = "/fragment@0/__overlay__/pm6125-tz/cooling-maps/trip0_cpu4:cooling-device:0", "/fragment@18/__overlay__/pm7250b-bcl-lvl0/cooling-maps/lbat0_cpufreq4:cooling-device:0";
		L11A = "/fragment@9/__overlay__:vdd-io-supply:0", "/fragment@12/__overlay__:vccq2-supply:0";
		L14A = "/fragment@21/__overlay__/wcd937x-codec:cdc-vdd-buck-supply:0";
		L15A = "/fragment@15/__overlay__/qcom,pm7250b@2/qcom,usb-pdphy@1700:vdd-pdphy-supply:0";
		L18A = "/fragment@11/__overlay__:vdda-pll-supply:0", "/fragment@12/__overlay__:qcom,vddp-ref-clk-supply:0";
		L22A = "/fragment@10/__overlay__:vdd-supply:0";
		L24A = "/fragment@9/__overlay__:vdd-supply:0", "/fragment@12/__overlay__:vcc-supply:0";
		L4A = "/fragment@11/__overlay__:vdda-phy-supply:0";
		L5A = "/fragment@10/__overlay__:vdd-io-supply:0";
		L7A = "/fragment@10/__overlay__:vdd-io-bias-supply:0";
		L9A = "/fragment@21/__overlay__/wcd937x-codec:cdc-vdd-rxtx-supply:0", "/fragment@21/__overlay__/wcd937x-codec:cdc-vddpx-supply:0";
		adsp_loader = "/fragment@25:target:0";
		adsp_variant = "/fragment@22/__overlay__/sound:nvmem-cells:0", "/fragment@25/__overlay__:nvmem-cells:0";
		ant_check_default = "/fragment@7/__overlay__/ant_check:pinctrl-0:0";
		ant_check_div_default = "/fragment@7/__overlay__/ant_check_div:pinctrl-0:0";
		audio_gpr = "/fragment@22/__overlay__/sound:qcom,msm_audio_ssr_devs:0";
		bolero_cdc = "/fragment@21:target:0", "/fragment@22/__overlay__/sound:asoc-codec:4", "/fragment@22/__overlay__/sound:qcom,msm_audio_ssr_devs:8";
		camera_therm_default = "/fragment@3/__overlay__:pinctrl-0:0";
		cdc_dmic01_gpios = "/fragment@22/__overlay__/sound:qcom,cdc-dmic01-gpios:0";
		cdc_dmic23_gpios = "/fragment@22/__overlay__/sound:qcom,cdc-dmic23-gpios:0";
		cdsp_sw = "/fragment@18/__overlay__/pm7250b-bcl-lvl0/cooling-maps/lbat0_cdsp:cooling-device:0", "/fragment@18/__overlay__/pm7250b-bcl-lvl1/cooling-maps/lbat1_cdsp:cooling-device:0", "/fragment@18/__overlay__/pm7250b-bcl-lvl2/cooling-maps/lbat2_cdsp:cooling-device:0";
		cpu1_pause = "/fragment@0/__overlay__/pm6125-tz/cooling-maps/trip1_cpu1:cooling-device:0";
		cpu2_pause = "/fragment@0/__overlay__/pm6125-tz/cooling-maps/trip1_cpu2:cooling-device:0";
		cpu3_pause = "/fragment@0/__overlay__/pm6125-tz/cooling-maps/trip1_cpu3:cooling-device:0";
		cpu4_pause = "/fragment@0/__overlay__/pm6125-tz/cooling-maps/trip1_cpu4:cooling-device:0", "/fragment@18/__overlay__/socd/cooling-maps/soc_cpu4:cooling-device:0", "/fragment@18/__overlay__/pm7250b-bcl-lvl1/cooling-maps/lbat1_cpu4:cooling-device:0";
		cpu5_pause = "/fragment@0/__overlay__/pm6125-tz/cooling-maps/trip1_cpu5:cooling-device:0", "/fragment@18/__overlay__/socd/cooling-maps/soc_cpu5:cooling-device:0", "/fragment@18/__overlay__/pm7250b-bcl-lvl1/cooling-maps/lbat1_cpu5:cooling-device:0";
		cpu6_pause = "/fragment@0/__overlay__/pm6125-tz/cooling-maps/trip1_cpu6:cooling-device:0", "/fragment@18/__overlay__/socd/cooling-maps/soc_cpu6:cooling-device:0", "/fragment@18/__overlay__/pm7250b-bcl-lvl0/cooling-maps/lbat0_cpu6:cooling-device:0";
		cpu7_pause = "/fragment@0/__overlay__/pm6125-tz/cooling-maps/trip1_cpu7:cooling-device:0", "/fragment@18/__overlay__/socd/cooling-maps/soc_cpu7:cooling-device:0", "/fragment@18/__overlay__/pm7250b-bcl-lvl0/cooling-maps/lbat0_cpu7:cooling-device:0";
		emmc_therm_default = "/fragment@3/__overlay__:pinctrl-0:4";
		gcc_ufs_phy_gdsc = "/fragment@12/__overlay__:vdd-hba-supply:0";
		lpass_audio_hw_vote = "/fragment@21/__overlay__/rx-macro@a600000/rx_swr_master:clocks:0", "/fragment@21/__overlay__/va-macro@a730000:clocks:0", "/fragment@21/__overlay__/va-macro@a730000/va_swr_master:clocks:0";
		lpi_i2s1_sck_active = "/fragment@22/__overlay__/pri_mi2s_pinctrl:pinctrl-0:0";
		lpi_i2s1_sck_sleep = "/fragment@22/__overlay__/pri_mi2s_pinctrl:pinctrl-1:0";
		lpi_i2s1_sd0_active = "/fragment@22/__overlay__/pri_mi2s_pinctrl:pinctrl-0:8";
		lpi_i2s1_sd0_sleep = "/fragment@22/__overlay__/pri_mi2s_pinctrl:pinctrl-1:8";
		lpi_i2s1_sd1_active = "/fragment@22/__overlay__/pri_mi2s_pinctrl:pinctrl-0:12";
		lpi_i2s1_sd1_sleep = "/fragment@22/__overlay__/pri_mi2s_pinctrl:pinctrl-1:12";
		lpi_i2s1_ws_active = "/fragment@22/__overlay__/pri_mi2s_pinctrl:pinctrl-0:4";
		lpi_i2s1_ws_sleep = "/fragment@22/__overlay__/pri_mi2s_pinctrl:pinctrl-1:4";
		lpi_i2s2_sck_active = "/fragment@22/__overlay__/sec_mi2s_pinctrl:pinctrl-0:0";
		lpi_i2s2_sck_sleep = "/fragment@22/__overlay__/sec_mi2s_pinctrl:pinctrl-1:0";
		lpi_i2s2_sd0_active = "/fragment@22/__overlay__/sec_mi2s_pinctrl:pinctrl-0:8";
		lpi_i2s2_sd0_sleep = "/fragment@22/__overlay__/sec_mi2s_pinctrl:pinctrl-1:8";
		lpi_i2s2_sd1_active = "/fragment@22/__overlay__/sec_mi2s_pinctrl:pinctrl-0:12";
		lpi_i2s2_sd1_sleep = "/fragment@22/__overlay__/sec_mi2s_pinctrl:pinctrl-1:12";
		lpi_i2s2_ws_active = "/fragment@22/__overlay__/sec_mi2s_pinctrl:pinctrl-0:4";
		lpi_i2s2_ws_sleep = "/fragment@22/__overlay__/sec_mi2s_pinctrl:pinctrl-1:4";
		lpi_tlmm = "/fragment@22/__overlay__/sound:qcom,msm_audio_ssr_devs:4";
		msm_gpu = "/fragment@18/__overlay__/pm7250b-bcl-lvl0/cooling-maps/lbat0_gpu:cooling-device:0", "/fragment@18/__overlay__/pm7250b-bcl-lvl1/cooling-maps/lbat1_gpu:cooling-device:0", "/fragment@18/__overlay__/pm7250b-bcl-lvl2/cooling-maps/lbat2_gpu:cooling-device:0";
		pm6125_adc_tm = "/fragment@4:target:0", "/fragment@5/__overlay__/rf-pa1-therm-usr:thermal-sensors:0";
		pm6125_gpios = "/fragment@6:target:0", "/fragment@7/__overlay__/gpio_keys/vol_up:gpios:0", "/fragment@7/__overlay__/vibrator_gpio:vib,en-gpio:0", "/fragment@7/__overlay__/vdda_usb_ss_dp_core:gpio:0";
		pm6125_l9 = "/fragment@1/__overlay__/fpc1020:vcc_spi-supply:0", "/fragment@1/__overlay__/fpc1020:vdd_io-supply:0", "/fragment@1/__overlay__/fpc1020:vdd_ana-supply:0", "/fragment@1/__overlay__/goodix_fp:vcc_spi_supply:0", "/fragment@1/__overlay__/goodix_fp:vcc_ana_supply:0", "/fragment@1/__overlay__/goodix_fp:vdd_io-supply:0";
		pm6125_pwm = "/fragment@13:target:0";
		pm6125_trip0 = "/fragment@0/__overlay__/pm6125-tz/cooling-maps/trip0_cpu0:trip:0", "/fragment@0/__overlay__/pm6125-tz/cooling-maps/trip0_cpu4:trip:0";
		pm6125_trip1 = "/fragment@0/__overlay__/pm6125-tz/cooling-maps/trip1_cpu1:trip:0", "/fragment@0/__overlay__/pm6125-tz/cooling-maps/trip1_cpu2:trip:0", "/fragment@0/__overlay__/pm6125-tz/cooling-maps/trip1_cpu3:trip:0", "/fragment@0/__overlay__/pm6125-tz/cooling-maps/trip1_cpu4:trip:0", "/fragment@0/__overlay__/pm6125-tz/cooling-maps/trip1_cpu5:trip:0", "/fragment@0/__overlay__/pm6125-tz/cooling-maps/trip1_cpu6:trip:0", "/fragment@0/__overlay__/pm6125-tz/cooling-maps/trip1_cpu7:trip:0";
		pm6125_vadc = "/fragment@3:target:0", "/fragment@4/__overlay__/rf_pa1_therm:io-channels:0";
		qupv3_se1_i2c = "/fragment@20:target:0", "/fragment@23:target:0";
		qupv3_se2_i2c = "/fragment@14:target:0";
		rpmcc = "/fragment@15/__overlay__/qcom,pm7250b@2/clock-controller@5b00:clocks:0";
		rx_swr_gpios = "/fragment@21/__overlay__/rx-macro@a600000:qcom,rx-swr-gpios:0";
		sdc1_off = "/fragment@9/__overlay__:pinctrl-1:0";
		sdc1_on = "/fragment@9/__overlay__:pinctrl-0:0";
		sdc2_off = "/fragment@10/__overlay__:pinctrl-1:0";
		sdc2_on = "/fragment@10/__overlay__:pinctrl-0:0";
		sdhc_1 = "/fragment@9:target:0";
		sdhc_2 = "/fragment@10:target:0";
		soc = "/fragment@1:target:0", "/fragment@7:target:0", "/fragment@19:target:0", "/fragment@24:target:0";
		spf_core_platform = "/fragment@22:target:0";
		spkr_1_sd_n_active = "/fragment@24/__overlay__/msm_cdc_pinctrl@106:pinctrl-0:0";
		spkr_1_sd_n_sleep = "/fragment@24/__overlay__/msm_cdc_pinctrl@106:pinctrl-1:0";
		spmi_bus = "/fragment@15:target:0", "/fragment@20/__overlay__/qcom,smb1355@c:interrupt-parent:0", "/fragment@20/__overlay__/qcom,smb1355@8:interrupt-parent:0";
		stub_codec = "/fragment@22/__overlay__/sound:asoc-codec:0";
		thermal_zones = "/fragment@0:target:0", "/fragment@5:target:0", "/fragment@16:target:0", "/fragment@17:target:0", "/fragment@18:target:0";
		tlmm = "/fragment@1/__overlay__/fpc1020:interrupt-parent:0", "/fragment@1/__overlay__/fpc1020:fpc,gpio_rst:0", "/fragment@1/__overlay__/fpc1020:fpc,gpio_irq:0", "/fragment@1/__overlay__/fpc1020:fpc,gpio_vdd_for_plsensor:0", "/fragment@1/__overlay__/goodix_fp:interrupt-parent:0", "/fragment@1/__overlay__/goodix_fp:fp-gpio-irq:0", "/fragment@1/__overlay__/goodix_fp:fp-gpio-reset:0", "/fragment@1/__overlay__/goodix_fp:fp-gpio-pwr:0", "/fragment@2:target:0", "/fragment@7/__overlay__/ant_check:interrupt-parent:0", "/fragment@7/__overlay__/ant_check:ant_check_gpio:0", "/fragment@7/__overlay__/ant_check_div:interrupt-parent:0", "/fragment@7/__overlay__/ant_check_div:ant_check_div_gpio:0", "/fragment@10/__overlay__:cd-gpios:0", "/fragment@12/__overlay__:reset-gpios:0", "/fragment@14/__overlay__/synaptics_tcm@20:interrupt-parent:0", "/fragment@14/__overlay__/synaptics_tcm@20:synaptics,irq-gpio:0", "/fragment@14/__overlay__/synaptics_tcm@20:synaptics,reset-gpio:0", "/fragment@14/__overlay__/novatek@62:interrupt-parent:0", "/fragment@14/__overlay__/novatek@62:novatek,reset-gpio:0", "/fragment@14/__overlay__/novatek@62:novatek,irq-gpio:0", "/fragment@23/__overlay__/fs16xx@34:fsm,rst-gpio:0", "/fragment@23/__overlay__/aw87xxx_pa_59@59:reset-gpio:0", "/fragment@24/__overlay__/si_pa_L:si,si_pa_reset:0";
		ts_int_active = "/fragment@14/__overlay__/synaptics_tcm@20:pinctrl-0:0", "/fragment@14/__overlay__/novatek@62:pinctrl-0:0";
		ts_int_suspend = "/fragment@14/__overlay__/synaptics_tcm@20:pinctrl-1:0", "/fragment@14/__overlay__/novatek@62:pinctrl-1:0";
		ts_release = "/fragment@14/__overlay__/synaptics_tcm@20:pinctrl-2:0", "/fragment@14/__overlay__/novatek@62:pinctrl-2:0";
		ts_reset_active = "/fragment@14/__overlay__/synaptics_tcm@20:pinctrl-0:4", "/fragment@14/__overlay__/novatek@62:pinctrl-0:4";
		ts_reset_suspend = "/fragment@14/__overlay__/synaptics_tcm@20:pinctrl-1:4", "/fragment@14/__overlay__/novatek@62:pinctrl-1:4";
		ufshc_mem = "/fragment@12:target:0";
		ufsphy_mem = "/fragment@11:target:0";
		usb2_phy0 = "/fragment@15/__overlay__/qcom,pm7250b@2/qcom,qpnp-smb5:dpdm-supply:0";
		usb_qmp_dp_phy = "/fragment@8:target:0";
		va_swr_gpios = "/fragment@21/__overlay__/va-macro@a730000:qcom,va-swr-gpios:0";
		wcd937x_reset_active = "/fragment@24/__overlay__/msm_cdc_pinctrl@92:pinctrl-0:0";
		wcd937x_reset_sleep = "/fragment@24/__overlay__/msm_cdc_pinctrl@92:pinctrl-1:0";
		wsa881x_analog_clk_gpio = "/fragment@23/__overlay__/wsa881x-i2c-codec@e:qcom,wsa-analog-clk-gpio:0";
	};

	__local_fixups__ {

		fragment@1 {

			__overlay__ {

				fpc1020 {
					pinctrl-0 = <0x0>;
					pinctrl-1 = <0x0>;
					pinctrl-2 = <0x0>;
				};

				goodix_fp {
					pinctrl-0 = <0x0>;
					pinctrl-1 = <0x0>;
					pinctrl-2 = <0x0>;
					pinctrl-3 = <0x0>;
				};
			};
		};

		fragment@15 {

			__overlay__ {

				qcom,pm7250b@2 {

					adc_tm@3500 {

						charger_skin_therm@4d {
							io-channels = <0x0>;
						};

						conn_therm@4f {
							io-channels = <0x0>;
						};
					};

					clock-controller@5b00 {
						assigned-clocks = <0x0>;
					};

					qcom,qpnp-smb5 {
						depends-on-supply = <0x0>;
						io-channels = <0x0 0x8 0x10 0x18 0x20 0x28 0x30 0x38 0x40 0x48 0x50 0x58 0x60 0x68 0x70 0x78 0x80 0x88 0x90 0x98 0xa0 0xa8 0xb0 0xb8>;
						qcom,battery-data = <0x0>;
					};

					qcom,temp-alarm@2400 {
						io-channels = <0x0>;
					};

					qcom,usb-pdphy@1700 {
						io-channels = <0x0 0x8 0x10 0x18 0x20 0x28 0x30 0x38 0x40 0x48 0x50 0x58 0x60 0x68>;
						vbus-supply = <0x0>;
						vconn-supply = <0x0>;
					};

					qpnp,qg {
						io-channels = <0x0 0x8 0x10 0x18 0x20 0x28>;
						qcom,battery-data = <0x0>;
					};
				};
			};
		};

		fragment@16 {

			__overlay__ {

				pm7250b-bcl-lvl0 {
					thermal-sensors = <0x0>;
				};

				pm7250b-bcl-lvl1 {
					thermal-sensors = <0x0>;
				};

				pm7250b-bcl-lvl2 {
					thermal-sensors = <0x0>;
				};

				pm7250b-ibat-lvl0 {
					thermal-sensors = <0x0>;
				};

				pm7250b-ibat-lvl1 {
					thermal-sensors = <0x0>;
				};

				pm7250b-tz {
					thermal-sensors = <0x0>;
				};

				socd {
					thermal-sensors = <0x0>;
				};
			};
		};

		fragment@17 {

			__overlay__ {

				charger-therm-usr {
					thermal-sensors = <0x0>;
				};

				conn-therm-usr {
					thermal-sensors = <0x0>;
				};
			};
		};

		fragment@18 {

			__overlay__ {

				pm7250b-bcl-lvl0 {

					cooling-maps {

						lbat0_cdsp {
							trip = <0x0>;
						};

						lbat0_cpu6 {
							trip = <0x0>;
						};

						lbat0_cpu7 {
							trip = <0x0>;
						};

						lbat0_cpufreq4 {
							trip = <0x0>;
						};

						lbat0_gpu {
							trip = <0x0>;
						};
					};
				};

				pm7250b-bcl-lvl1 {

					cooling-maps {

						lbat1_cdsp {
							trip = <0x0>;
						};

						lbat1_cpu4 {
							trip = <0x0>;
						};

						lbat1_cpu5 {
							trip = <0x0>;
						};

						lbat1_gpu {
							trip = <0x0>;
						};
					};
				};

				pm7250b-bcl-lvl2 {

					cooling-maps {

						lbat2_cdsp {
							trip = <0x0>;
						};

						lbat2_gpu {
							trip = <0x0>;
						};
					};
				};

				pm7250b-tz {

					cooling-maps {

						trip0_bat {
							cooling-device = <0x0>;
							trip = <0x0>;
						};

						trip1_bat {
							cooling-device = <0x0>;
							trip = <0x0>;
						};
					};
				};

				socd {

					cooling-maps {

						soc_cpu4 {
							trip = <0x0>;
						};

						soc_cpu5 {
							trip = <0x0>;
						};

						soc_cpu6 {
							trip = <0x0>;
						};

						soc_cpu7 {
							trip = <0x0>;
						};
					};
				};
			};
		};

		fragment@20 {

			__overlay__ {

				qcom,smb1355@8 {

					qcom,smb1355-charger@1000 {
						interrupt-parent = <0x0>;
					};
				};

				qcom,smb1355@c {
					pinctrl-0 = <0x0>;

					qcom,smb1355-charger@1000 {
						interrupt-parent = <0x0>;
					};
				};
			};
		};

		fragment@21 {

			__overlay__ {

				bolero-clk-rsc-mngr {
					clocks = <0x0 0x8 0x10 0x18 0x20 0x28>;
				};

				rx-macro@a600000 {
					clocks = <0x0 0x8>;
				};

				tx-macro@a620000 {
					clocks = <0x0 0x8>;
				};

				wcd937x-codec {
					qcom,rx-slave = <0x0>;
					qcom,tx-slave = <0x0>;
					qcom,wcd-rst-gpio-node = <0x0>;
				};
			};
		};

		fragment@22 {

			__overlay__ {

				sound {
					asoc-codec = <0x8>;
					si,sia81xx-aux-devs = <0x0>;
				};
			};
		};

		fragment@23 {

			__overlay__ {

				sipa_i2c_L@2b {
					si,sipa-dev = <0x0>;
				};

				wsa881x-i2c-codec@e {
					clocks = <0x0>;
					qcom,wsa-analog-reset-gpio = <0x0>;
				};
			};
		};

		fragment@3 {

			__overlay__ {
				pinctrl-0 = <0x8>;
			};
		};

		fragment@7 {

			__overlay__ {

				gpio_keys {
					pinctrl-0 = <0x0>;
				};

				vdda_usb_ss_dp_core {
					pinctrl-0 = <0x0>;
				};

				vibrator_gpio {
					pinctrl-0 = <0x0>;
				};
			};
		};

		fragment@8 {

			__overlay__ {
				vdd-supply = <0x0>;
			};
		};
	};

	__symbols__ {
		b_bcl_lvl0 = "/fragment@16/__overlay__/pm7250b-bcl-lvl0/trips/b-bcl-lvl0";
		b_bcl_lvl1 = "/fragment@16/__overlay__/pm7250b-bcl-lvl1/trips/b-bcl-lvl1";
		b_bcl_lvl2 = "/fragment@16/__overlay__/pm7250b-bcl-lvl2/trips/b-bcl-lvl2";
		bcl_soc = "/fragment@15/__overlay__/qcom,pm7250b@2/bcl-soc";
		bengal_snd = "/fragment@22/__overlay__/sound";
		cdc_pri_mi2s_gpios = "/fragment@22/__overlay__/pri_mi2s_pinctrl";
		cdc_sec_mi2s_gpios = "/fragment@22/__overlay__/sec_mi2s_pinctrl";
		clock_audio_rx_1 = "/fragment@24/__overlay__/rx_core_clk";
		clock_audio_rx_2 = "/fragment@24/__overlay__/rx_npl_clk";
		clock_audio_tx_1 = "/fragment@24/__overlay__/tx_core_clk";
		clock_audio_tx_2 = "/fragment@24/__overlay__/tx_npl_clk";
		clock_audio_va_1 = "/fragment@24/__overlay__/va_core_clk";
		clock_audio_va_2 = "/fragment@24/__overlay__/va_npl_clk";
		disp_lcd_bias_en_default = "/fragment@15/__overlay__/qcom,pm7250b@2/pinctrl@c000/disp_lcd_bias_en/disp_lcd_bias_en_default";
		ibat_lvl0 = "/fragment@16/__overlay__/pm7250b-ibat-lvl0/trips/ibat-lvl0";
		ibat_lvl1 = "/fragment@16/__overlay__/pm7250b-ibat-lvl1/trips/ibat-lvl1";
		key_vol_up_default = "/fragment@6/__overlay__/key_vol_up/key_vol_up_default";
		msm_gpio_104 = "/fragment@2/__overlay__/msm_gpio_104";
		msm_gpio_104_output_high = "/fragment@2/__overlay__/msm_gpio_104_output_high";
		msm_gpio_65 = "/fragment@2/__overlay__/msm_gpio_65";
		msm_gpio_65_output_high = "/fragment@2/__overlay__/msm_gpio_65_output_high";
		msm_gpio_83 = "/fragment@2/__overlay__/msm_gpio_83";
		mtp_batterydata = "/fragment@19/__overlay__/qcom,battery-data";
		oled_vci_default = "/fragment@6/__overlay__/oled_vci/oled_vci_default";
		oled_vci_suspend = "/fragment@6/__overlay__/oled_vci/oled_vci_suspend";
		pm7250b_adc_tm = "/fragment@15/__overlay__/qcom,pm7250b@2/adc_tm@3500";
		pm7250b_bcl = "/fragment@15/__overlay__/qcom,pm7250b@2/bcl@1d00";
		pm7250b_charger = "/fragment@15/__overlay__/qcom,pm7250b@2/qcom,qpnp-smb5";
		pm7250b_clkdiv = "/fragment@15/__overlay__/qcom,pm7250b@2/clock-controller@5b00";
		pm7250b_gpios = "/fragment@15/__overlay__/qcom,pm7250b@2/pinctrl@c000";
		pm7250b_pdphy = "/fragment@15/__overlay__/qcom,pm7250b@2/qcom,usb-pdphy@1700";
		pm7250b_qg = "/fragment@15/__overlay__/qcom,pm7250b@2/qpnp,qg";
		pm7250b_smb_int_default = "/fragment@15/__overlay__/qcom,pm7250b@2/pinctrl@c000/pm7250b_smb_int_default";
		pm7250b_temp_alarm = "/fragment@16/__overlay__/pm7250b-tz";
		pm7250b_trip0 = "/fragment@16/__overlay__/pm7250b-tz/trips/trip0";
		pm7250b_trip1 = "/fragment@16/__overlay__/pm7250b-tz/trips/trip1";
		pm7250b_tz = "/fragment@15/__overlay__/qcom,pm7250b@2/qcom,temp-alarm@2400";
		pm7250b_vadc = "/fragment@15/__overlay__/qcom,pm7250b@2/vadc@3100";
		pm7250b_vib = "/fragment@15/__overlay__/qcom,pm7250b@3/qcom,vibrator@5300";
		rf_pa1_therm_default = "/fragment@6/__overlay__/rf_pa1_therm/rf_pa1_therm_default";
		rx_macro = "/fragment@21/__overlay__/rx-macro@a600000";
		si_pa_L = "/fragment@24/__overlay__/si_pa_L";
		sipa_i2c_L = "/fragment@23/__overlay__/sipa_i2c_L@2b";
		smb1355 = "/fragment@20/__overlay__/qcom,smb1355@c";
		smb1355_0 = "/fragment@20/__overlay__/qcom,smb1355@8";
		smb1355_charger = "/fragment@20/__overlay__/qcom,smb1355@c/qcom,smb1355-charger@1000";
		smb1355_charger_0 = "/fragment@20/__overlay__/qcom,smb1355@8/qcom,smb1355-charger@1000";
		smb5_vbus = "/fragment@15/__overlay__/qcom,pm7250b@2/qcom,qpnp-smb5/qcom,smb5-vbus";
		smb5_vconn = "/fragment@15/__overlay__/qcom,pm7250b@2/qcom,qpnp-smb5/qcom,smb5-vconn";
		soc_trip = "/fragment@16/__overlay__/socd/trips/soc-trip";
		swr0 = "/fragment@21/__overlay__/va-macro@a730000/va_swr_master";
		swr1 = "/fragment@21/__overlay__/rx-macro@a600000/rx_swr_master";
		tx_macro = "/fragment@21/__overlay__/tx-macro@a620000";
		usb_eldo9 = "/fragment@6/__overlay__/eldo9_pin/gpio@c000";
		va_macro = "/fragment@21/__overlay__/va-macro@a730000";
		vdda_usb_ss_dp_core = "/fragment@7/__overlay__/vdda_usb_ss_dp_core";
		vib_out_gpio8_default = "/fragment@6/__overlay__/vib_out_gpio8/vib_out_gpio8_default";
		wcd937x_codec = "/fragment@21/__overlay__/wcd937x-codec";
		wcd937x_rst_gpio = "/fragment@24/__overlay__/msm_cdc_pinctrl@92";
		wcd937x_rx_slave = "/fragment@21/__overlay__/rx-macro@a600000/rx_swr_master/wcd937x-rx-slave";
		wcd937x_tx_slave = "/fragment@21/__overlay__/va-macro@a730000/va_swr_master/wcd937x-tx-slave";
		wsa881x_analog_clk = "/fragment@24/__overlay__/wsa_ana_clk";
		wsa881x_analog_reset_gpio = "/fragment@24/__overlay__/msm_cdc_pinctrl@106";
		wsa881x_i2c_44 = "/fragment@23/__overlay__/wsa881x-i2c-codec@44";
		wsa881x_i2c_e = "/fragment@23/__overlay__/wsa881x-i2c-codec@e";
	};

	fragment@0 {
		target = <0xffffffff>;

		__overlay__ {

			pm6125-tz {

				cooling-maps {

					trip0_cpu0 {
						cooling-device = <0xffffffff 0x7 0x7>;
						trip = <0xffffffff>;
					};

					trip0_cpu4 {
						cooling-device = <0xffffffff 0x6 0xffffffff>;
						trip = <0xffffffff>;
					};

					trip1_cpu1 {
						cooling-device = <0xffffffff 0x1 0x1>;
						trip = <0xffffffff>;
					};

					trip1_cpu2 {
						cooling-device = <0xffffffff 0x1 0x1>;
						trip = <0xffffffff>;
					};

					trip1_cpu3 {
						cooling-device = <0xffffffff 0x1 0x1>;
						trip = <0xffffffff>;
					};

					trip1_cpu4 {
						cooling-device = <0xffffffff 0x1 0x1>;
						trip = <0xffffffff>;
					};

					trip1_cpu5 {
						cooling-device = <0xffffffff 0x1 0x1>;
						trip = <0xffffffff>;
					};

					trip1_cpu6 {
						cooling-device = <0xffffffff 0x1 0x1>;
						trip = <0xffffffff>;
					};

					trip1_cpu7 {
						cooling-device = <0xffffffff 0x1 0x1>;
						trip = <0xffffffff>;
					};
				};
			};
		};
	};

	fragment@1 {
		target = <0xffffffff>;

		__overlay__ {

			fpc1020 {
				compatible = "fpc,fpc1020";
				fpc,enable-on-boot;
				fpc,gpio_irq = <0xffffffff 0x53 0x0>;
				fpc,gpio_rst = <0xffffffff 0x68 0x0>;
				fpc,gpio_vdd_for_plsensor = <0xffffffff 0x41 0x0>;
				interrupt-parent = <0xffffffff>;
				interrupts = <0x53 0x0>;
				pinctrl-0 = <0x1>;
				pinctrl-1 = <0x2>;
				pinctrl-2 = <0x3>;
				pinctrl-names = "fpc1020_reset_reset", "fpc1020_reset_active", "fpc1020_irq_active";
				status = "ok";
				vcc_spi-supply = <0xffffffff>;
				vdd_ana-supply = <0xffffffff>;
				vdd_io-supply = <0xffffffff>;
			};

			goodix_fp {
				compatible = "goodix,fingerprint";
				fp-gpio-irq = <0xffffffff 0x53 0x0>;
				fp-gpio-pwr = <0xffffffff 0x41 0x0>;
				fp-gpio-reset = <0xffffffff 0x68 0x0>;
				interrupt = <0x53 0x0>;
				interrupt-parent = <0xffffffff>;
				pinctrl-0 = <0x1>;
				pinctrl-1 = <0x2>;
				pinctrl-2 = <0x4>;
				pinctrl-3 = <0x5>;
				pinctrl-names = "goodix_reset_outputlow", "goodix_reset_outputhigh", "goodix_pwr_outputlow", "goodix_pwr_outputhigh";
				status = "okay";
				vcc_ana_supply = <0xffffffff>;
				vcc_spi_supply = <0xffffffff>;
				vdd_io-supply = <0xffffffff>;
			};
		};
	};

	fragment@10 {
		target = <0xffffffff>;

		__overlay__ {
			cd-gpios = <0xffffffff 0x58 0x1>;
			pinctrl-0 = <0xffffffff>;
			pinctrl-1 = <0xffffffff>;
			pinctrl-names = "default", "sleep";
			qcom,vdd-current-level = <0x0 0xc3500>;
			qcom,vdd-io-bias-current-level = <0x0 0x1770>;
			qcom,vdd-io-bias-voltage-level = <0x132a40 0x132a40>;
			qcom,vdd-io-current-level = <0x0 0x55f0>;
			qcom,vdd-io-voltage-level = <0x1b7740 0x2d2a80>;
			qcom,vdd-voltage-level = <0x2d2a80 0x2d2a80>;
			status = "ok";
			vdd-io-bias-supply = <0xffffffff>;
			vdd-io-supply = <0xffffffff>;
			vdd-supply = <0xffffffff>;
		};
	};

	fragment@11 {
		target = <0xffffffff>;

		__overlay__ {
			compatible = "qcom,ufs-phy-qmp-v4-khaje";
			status = "ok";
			vdda-phy-max-microamp = <0x14ec4>;
			vdda-phy-supply = <0xffffffff>;
			vdda-pll-max-microamp = <0x477c>;
			vdda-pll-supply = <0xffffffff>;
		};
	};

	fragment@12 {
		target = <0xffffffff>;

		__overlay__ {
			qcom,vddp-ref-clk-max-microamp = <0x64>;
			qcom,vddp-ref-clk-supply = <0xffffffff>;
			reset-gpios = <0xffffffff 0x71 0x1>;
			reset-names = "rst";
			status = "ok";
			vcc-max-microamp = <0xc3500>;
			vcc-supply = <0xffffffff>;
			vccq2-max-microamp = <0xc3500>;
			vccq2-supply = <0xffffffff>;
			vdd-hba-fixed-regulator;
			vdd-hba-supply = <0xffffffff>;
		};
	};

	fragment@13 {
		target = <0xffffffff>;

		__overlay__ {
			status = "ok";
		};
	};

	fragment@14 {
		target = <0xffffffff>;

		__overlay__ {
			qcom,i2c-touch-active = "synaptics,tcm-i2c";
			status = "okay";

			novatek@62 {
				interrupt-parent = <0xffffffff>;
				interrupts = <0x50 0x2008>;
				novatek,irq-gpio = <0xffffffff 0x50 0x2008>;
				novatek,reset-gpio = <0xffffffff 0x56 0x0>;
				pinctrl-0 = <0xffffffff 0xffffffff>;
				pinctrl-1 = <0xffffffff 0xffffffff>;
				pinctrl-2 = <0xffffffff>;
				pinctrl-names = "pmx_ts_active", "pmx_ts_suspend", "pmx_ts_release";
				reg = <0x62>;
				status = "ok";
			};

			synaptics_tcm@20 {
				compatible = "synaptics,tcm-i2c";
				interrupt-parent = <0xffffffff>;
				interrupts = <0x50 0x2008>;
				pinctrl-0 = <0xffffffff 0xffffffff>;
				pinctrl-1 = <0xffffffff 0xffffffff>;
				pinctrl-2 = <0xffffffff>;
				pinctrl-names = "pmx_ts_active", "pmx_ts_suspend", "pmx_ts_release";
				reg = <0x20>;
				synaptics,extend_report;
				synaptics,firmware-name = "synaptics_firmware_k.img";
				synaptics,irq-gpio = <0xffffffff 0x50 0x2008>;
				synaptics,irq-on-state = <0x0>;
				synaptics,power-delay-ms = <0xc8>;
				synaptics,reset-active-ms = <0x14>;
				synaptics,reset-delay-ms = <0xc8>;
				synaptics,reset-gpio = <0xffffffff 0x56 0x0>;
				synaptics,reset-on-state = <0x0>;
				synaptics,ubl-i2c-addr = <0x20>;
			};
		};
	};

	fragment@15 {
		target = <0xffffffff>;

		__overlay__ {
			#address-cells = <0x2>;
			#interrupt-cells = <0x4>;
			#size-cells = <0x0>;
			interrupt-controller;

			qcom,pm7250b@2 {
				#address-cells = <0x1>;
				#size-cells = <0x0>;
				compatible = "qcom,spmi-pmic";
				reg = <0x2 0x0>;

				adc_tm@3500 {
					#address-cells = <0x1>;
					#size-cells = <0x0>;
					#thermal-sensor-cells = <0x1>;
					compatible = "qcom,spmi-adc-tm5";
					interrupt-names = "pm-adc-tm5";
					interrupts = <0x2 0x35 0x0 0x1>;
					phandle = <0x15>;
					reg = <0x3500>;
					status = "ok";

					charger_skin_therm@4d {
						io-channels = <0xb 0x4d>;
						qcom,hw-settle-time-us = <0xc8>;
						qcom,ratiometric;
						reg = <0x0>;
					};

					conn_therm@4f {
						io-channels = <0xb 0x4f>;
						qcom,hw-settle-time-us = <0xc8>;
						qcom,ratiometric;
						reg = <0x1>;
					};
				};

				bcl-soc {
					#thermal-sensor-cells = <0x0>;
					compatible = "qcom,msm-bcl-soc";
					phandle = <0x14>;
				};

				bcl@1d00 {
					#thermal-sensor-cells = <0x1>;
					compatible = "qcom,bcl-v5";
					interrupt-names = "bcl-lvl0", "bcl-lvl1", "bcl-lvl2";
					interrupts = <0x2 0x1d 0x0 0x0 0x2 0x1d 0x1 0x0 0x2 0x1d 0x2 0x0>;
					phandle = <0x13>;
					reg = <0x1d00>;
				};

				clock-controller@5b00 {
					#clock-cells = <0x1>;
					assigned-clock-rates = <0x124f800>;
					assigned-clocks = <0x11 0x1>;
					clock-names = "xo";
					clock-output-names = "pm7250b_div_clk1";
					clocks = <0xffffffff 0x0>;
					compatible = "qcom,spmi-clkdiv";
					phandle = <0x11>;
					qcom,num-clkdivs = <0x1>;
					reg = <0x5b00>;
				};

				pinctrl@c000 {
					#gpio-cells = <0x2>;
					#interrupt-cells = <0x2>;
					compatible = "qcom,pm7250b-gpio";
					gpio-controller;
					interrupt-controller;
					phandle = <0x22>;
					reg = <0xc000>;

					disp_lcd_bias_en {

						disp_lcd_bias_en_default {
							bias-disable;
							function = "func1";
							input-disable;
							output-enable;
							phandle = <0x23>;
							pins = "gpio5";
							power-source = <0x0>;
							qcom,drive-strength = <0x2>;
						};
					};

					pm7250b_smb_int_default {
						bias-pull-up;
						function = "gpio";
						input-enable;
						phandle = <0x1c>;
						pins = "gpio6";
						power-source = <0x0>;
						qcom,pull-up-strength = <0x0>;
					};
				};

				qcom,qpnp-smb5 {
					#address-cells = <0x1>;
					#cooling-cells = <0x2>;
					#io-channel-cells = <0x1>;
					#size-cells = <0x1>;
					compatible = "qcom,pm7250b-smb5";
					depends-on-supply = <0xb>;
					dpdm-supply = <0xffffffff>;
					io-channel-names = "usb_in_voltage", "usb_in_current", "chg_temp", "die_temp", "conn_temp", "sbux_res", "vph_voltage", "skin_temp", "resistance_id", "voltage_now", "temp", "capacity", "voltage_ocv", "voltage_avg", "debug_battery", "real_capacity", "cc_soc", "current_now", "voltage_max", "charge_full", "charge_counter", "cycle_count", "charge_full_design", "time_to_full_now";
					io-channels = <0xb 0x8 0xb 0x7 0xb 0x9 0xb 0x6 0xb 0x4f 0xb 0x99 0xb 0x83 0xb 0x4d 0xc 0x4b 0xc 0x46 0xc 0x45 0xc 0x42 0xc 0x47 0xc 0x5d 0xc 0x4e 0xc 0x44 0xc 0x5b 0xc 0x48 0xc 0x2d 0xc 0x53 0xc 0x49 0xc 0x52 0xc 0x54 0xc 0x56>;
					phandle = <0x10>;
					qcom,auto-recharge-soc = <0x62>;
					qcom,battery-data = <0xd>;
					qcom,charger-temp-max = <0x320>;
					qcom,en-skin-therm-mitigation;
					qcom,fcc-step-delay-ms = <0x64>;
					qcom,fcc-step-size-ua = <0x186a0>;
					qcom,fcc-stepping-enable;
					qcom,hvdcp2-12v-max-icl-ua = <0x16e360>;
					qcom,hvdcp2-max-icl-ua = <0x1e8480>;
					qcom,hvdcp3-standalone-config;
					qcom,sec-charger-config = <0x2>;
					qcom,smb-internal-pull-kohm = <0x0>;
					qcom,smb-temp-max = <0x320>;
					qcom,step-charging-enable;
					qcom,suspend-input-on-debug-batt;
					qcom,sw-jeita-enable;
					qcom,thermal-mitigation = <0x5265c0 0x44aa20 0x3d0900 0x3567e0 0x2dc6c0 0x2625a0 0x1e8480 0x16e360 0xf4240 0x7a120>;
					status = "ok";

					qcom,batif@1200 {
						interrupt-names = "bat-temp", "bat-ov", "bat-low", "bat-therm-or-id-missing", "bat-terminal-missing", "buck-oc", "vph-ov";
						interrupts = <0x2 0x12 0x0 0x1 0x2 0x12 0x2 0x3 0x2 0x12 0x3 0x3 0x2 0x12 0x4 0x3 0x2 0x12 0x5 0x3 0x2 0x12 0x6 0x3 0x2 0x12 0x7 0x3>;
						reg = <0x1200>;
					};

					qcom,chg-sdam@b000 {
						reg = <0xb000>;
					};

					qcom,chgr@1000 {
						interrupt-names = "chgr-error", "chg-state-change", "step-chg-state-change", "step-chg-soc-update-fail", "step-chg-soc-update-req", "fg-fvcal-qualified", "vph-alarm", "vph-drop-prechg";
						interrupts = <0x2 0x10 0x0 0x1 0x2 0x10 0x1 0x1 0x2 0x10 0x2 0x1 0x2 0x10 0x3 0x1 0x2 0x10 0x4 0x1 0x2 0x10 0x5 0x1 0x2 0x10 0x6 0x1 0x2 0x10 0x7 0x1>;
						reg = <0x1000>;
					};

					qcom,dc@1400 {
						interrupt-names = "dcin-vashdn", "dcin-uv", "dcin-ov", "dcin-plugin", "dcin-revi", "dcin-pon", "dcin-en";
						interrupts = <0x2 0x14 0x1 0x3 0x2 0x14 0x2 0x3 0x2 0x14 0x3 0x3 0x2 0x14 0x4 0x3 0x2 0x14 0x5 0x3 0x2 0x14 0x6 0x1 0x2 0x14 0x7 0x1>;
						reg = <0x1400>;
					};

					qcom,dcdc@1100 {
						interrupt-names = "otg-fail", "otg-oc-disable-sw", "otg-oc-hiccup", "bsm-active", "high-duty-cycle", "input-current-limiting", "concurrent-mode-disable", "switcher-power-ok";
						interrupts = <0x2 0x11 0x0 0x1 0x2 0x11 0x1 0x1 0x2 0x11 0x2 0x1 0x2 0x11 0x3 0x3 0x2 0x11 0x4 0x3 0x2 0x11 0x5 0x3 0x2 0x11 0x6 0x1 0x2 0x11 0x7 0x3>;
						reg = <0x1100>;
					};

					qcom,misc@1600 {
						interrupt-names = "wdog-snarl", "wdog-bark", "aicl-fail", "aicl-done", "smb-en", "imp-trigger", "temp-change", "temp-change-smb";
						interrupts = <0x2 0x16 0x0 0x1 0x2 0x16 0x1 0x1 0x2 0x16 0x2 0x1 0x2 0x16 0x3 0x1 0x2 0x16 0x4 0x3 0x2 0x16 0x5 0x1 0x2 0x16 0x6 0x1 0x2 0x16 0x7 0x1>;
						reg = <0x1600>;
					};

					qcom,smb5-vbus {
						phandle = <0xe>;
						regulator-name = "smb5-vbus";
					};

					qcom,smb5-vconn {
						phandle = <0xf>;
						regulator-name = "smb5-vconn";
					};

					qcom,typec@1500 {
						interrupt-names = "typec-or-rid-detect-change", "typec-vpd-detect", "typec-cc-state-change", "typec-vconn-oc", "typec-vbus-change", "typec-attach-detach", "typec-legacy-cable-detect", "typec-try-snk-src-detect";
						interrupts = <0x2 0x15 0x0 0x1 0x2 0x15 0x1 0x1 0x2 0x15 0x2 0x1 0x2 0x15 0x3 0x1 0x2 0x15 0x4 0x1 0x2 0x15 0x5 0x1 0x2 0x15 0x6 0x1 0x2 0x15 0x7 0x1>;
						reg = <0x1500>;
					};

					qcom,usb@1300 {
						interrupt-names = "usbin-collapse", "usbin-vashdn", "usbin-uv", "usbin-ov", "usbin-plugin", "usbin-revi-change", "usbin-src-change", "usbin-icl-change";
						interrupts = <0x2 0x13 0x0 0x3 0x2 0x13 0x1 0x3 0x2 0x13 0x2 0x3 0x2 0x13 0x3 0x3 0x2 0x13 0x4 0x3 0x2 0x13 0x5 0x3 0x2 0x13 0x6 0x1 0x2 0x13 0x7 0x1>;
						reg = <0x1300>;
					};
				};

				qcom,temp-alarm@2400 {
					#thermal-sensor-cells = <0x0>;
					compatible = "qcom,spmi-temp-alarm";
					interrupts = <0x2 0x24 0x0 0x3>;
					io-channel-names = "thermal";
					io-channels = <0xb 0x6>;
					phandle = <0x12>;
					qcom,temperature-threshold-set = <0x1>;
					reg = <0x2400>;
				};

				qcom,usb-pdphy@1700 {
					#io-channel-cells = <0x1>;
					compatible = "qcom,qpnp-pdphy";
					interrupt-names = "sig-tx", "sig-rx", "msg-tx", "msg-rx", "msg-tx-failed", "msg-tx-discarded", "msg-rx-discarded", "fr-swap";
					interrupts = <0x2 0x17 0x0 0x1 0x2 0x17 0x1 0x1 0x2 0x17 0x2 0x1 0x2 0x17 0x3 0x1 0x2 0x17 0x4 0x1 0x2 0x17 0x5 0x1 0x2 0x17 0x6 0x1 0x2 0x17 0x7 0x1>;
					io-channel-names = "pd_active", "typec_cc_orientation", "connector_type", "typec_power_role", "pd_usb_suspend_supported", "typec_src_rp", "pd_in_hard_reset", "pr_current_max", "pr_swap", "pd_voltage_min", "pd_voltage_max", "real_type", "typec_mode", "pe_start";
					io-channels = <0x10 0x4 0x10 0x3 0x10 0xd 0x10 0x2 0x10 0x1f 0x10 0x1d 0x10 0x1e 0x10 0x0 0x10 0x20 0x10 0xc 0x10 0xb 0x10 0xa 0x10 0x1 0x10 0x7>;
					phandle = <0x21>;
					qcom,default-sink-caps = <0x1388 0xbb8 0x2328 0xbb8 0x2ee0 0x8ca>;
					reg = <0x1700>;
					vbus-supply = <0xe>;
					vconn-supply = <0xf>;
					vdd-pdphy-supply = <0xffffffff>;
				};

				qpnp,qg {
					#address-cells = <0x1>;
					#io-channel-cells = <0x1>;
					#size-cells = <0x1>;
					compatible = "qcom,pm7250b-qg";
					io-channel-names = "batt-therm", "batt-id", "input_current_limited", "recharge_soc", "force_recharge", "charge_done";
					io-channels = <0xb 0x4a 0xb 0x4b 0x10 0x37 0x10 0x3f 0x10 0x40 0x10 0x39>;
					phandle = <0xc>;
					qcom,bass-enable;
					qcom,battery-data = <0xd>;
					qcom,cl-feedback-on;
					qcom,fvss-enable;
					qcom,fvss-vbatt-mv = <0xdac>;
					qcom,hold-soc-while-full;
					qcom,linearize-soc;
					qcom,qg-iterm-ma = <0x64>;
					qcom,s3-entry-fifo-length = <0x2>;
					qcom,tcss-enable;
					qcom,vbatt-cutoff-mv = <0xd48>;
					qcom,vbatt-empty-cold-mv = <0xc1c>;
					qcom,vbatt-empty-mv = <0xc80>;
					qcom,vbatt-low-cold-mv = <0xed8>;
					qcom,vbatt-low-mv = <0xdac>;
					status = "ok";

					qcom,qg-sdam@b100 {
						reg = <0xb100>;
						status = "okay";
					};

					qcom,qgauge@4800 {
						interrupt-names = "qg-batt-missing", "qg-vbat-low", "qg-vbat-empty", "qg-fifo-done", "qg-good-ocv";
						interrupts = <0x2 0x48 0x0 0x3 0x2 0x48 0x1 0x3 0x2 0x48 0x2 0x1 0x2 0x48 0x3 0x1 0x2 0x48 0x4 0x1>;
						reg = <0x4800>;
						status = "okay";
					};
				};

				vadc@3100 {
					#address-cells = <0x1>;
					#io-channel-cells = <0x1>;
					#size-cells = <0x0>;
					compatible = "qcom,spmi-adc5";
					interrupt-names = "eoc-int-en-set";
					interrupts = <0x2 0x31 0x0 0x1>;
					io-channel-ranges;
					phandle = <0xb>;
					qcom,adc-vdd-reference = <0x753>;
					reg = <0x3100>;
					reg-names = "adc5-usr-base";

					bat_id@4b {
						label = "bat_id";
						qcom,hw-settle-time = <0xc8>;
						qcom,pre-scaling = <0x1 0x1>;
						qcom,ratiometric;
						reg = <0x4b>;
					};

					bat_therm@4a {
						label = "bat_therm";
						qcom,hw-settle-time = <0xc8>;
						qcom,pre-scaling = <0x1 0x1>;
						qcom,ratiometric;
						reg = <0x4a>;
					};

					bat_therm_30k@2a {
						label = "bat_therm_30k";
						qcom,hw-settle-time = <0xc8>;
						qcom,pre-scaling = <0x1 0x1>;
						qcom,ratiometric;
						reg = <0x2a>;
					};

					bat_therm_400k@6a {
						label = "bat_therm_400k";
						qcom,hw-settle-time = <0xc8>;
						qcom,pre-scaling = <0x1 0x1>;
						qcom,ratiometric;
						reg = <0x6a>;
					};

					charger_skin_therm@4d {
						label = "charger_skin_therm";
						qcom,hw-settle-time = <0xc8>;
						qcom,pre-scaling = <0x1 0x1>;
						qcom,ratiometric;
						reg = <0x4d>;
					};

					chg_sbux@99 {
						label = "chg_sbux";
						qcom,pre-scaling = <0x1 0x3>;
						reg = <0x99>;
					};

					chg_temp@9 {
						label = "chg_temp";
						qcom,pre-scaling = <0x1 0x1>;
						reg = <0x9>;
					};

					conn_therm@4f {
						label = "conn_therm";
						qcom,hw-settle-time = <0xc8>;
						qcom,pre-scaling = <0x1 0x1>;
						qcom,ratiometric;
						reg = <0x4f>;
					};

					die_temp@2 {
						label = "die_temp";
						qcom,pre-scaling = <0x1 0x1>;
						reg = <0x6>;
					};

					mid_chg_div6@1e {
						label = "chg_mid";
						qcom,pre-scaling = <0x1 0x6>;
						reg = <0x1e>;
					};

					ref_gnd@0 {
						label = "ref_gnd";
						qcom,pre-scaling = <0x1 0x1>;
						reg = <0x0>;
					};

					smb1390_therm@e {
						label = "smb1390_therm";
						qcom,hw-settle-time = <0xc8>;
						qcom,pre-scaling = <0x1 0x1>;
						reg = <0xe>;
					};

					usb_in_i_uv@7 {
						label = "usb_in_i_uv";
						qcom,pre-scaling = <0x1 0x1>;
						reg = <0x7>;
					};

					usb_in_v_div_16@8 {
						label = "usb_in_v_div_16";
						qcom,pre-scaling = <0x1 0x10>;
						reg = <0x8>;
					};

					vbat_sns@84 {
						label = "vbat_sns";
						qcom,pre-scaling = <0x1 0x3>;
						reg = <0x84>;
					};

					vph_pwr@83 {
						label = "vph_pwr";
						qcom,pre-scaling = <0x1 0x3>;
						reg = <0x83>;
					};

					vref_1p25@1 {
						label = "vref_1p25";
						qcom,pre-scaling = <0x1 0x1>;
						reg = <0x1>;
					};
				};
			};

			qcom,pm7250b@3 {
				#address-cells = <0x1>;
				#size-cells = <0x0>;
				compatible = "qcom,spmi-pmic";
				reg = <0x3 0x0>;

				qcom,vibrator@5300 {
					compatible = "qcom,qpnp-vibrator-ldo";
					phandle = <0x24>;
					qcom,disable-overdrive;
					qcom,vib-ldo-volt-uv = <0x2dc6c0>;
					reg = <0x5300>;
				};
			};
		};
	};

	fragment@16 {
		target = <0xffffffff>;

		__overlay__ {

			pm7250b-bcl-lvl0 {
				polling-delay = <0x0>;
				polling-delay-passive = <0x64>;
				thermal-sensors = <0x13 0x5>;

				trips {

					b-bcl-lvl0 {
						hysteresis = <0x1>;
						phandle = <0x19>;
						temperature = <0x1>;
						type = "passive";
					};
				};
			};

			pm7250b-bcl-lvl1 {
				polling-delay = <0x0>;
				polling-delay-passive = <0x64>;
				thermal-sensors = <0x13 0x6>;

				trips {

					b-bcl-lvl1 {
						hysteresis = <0x1>;
						phandle = <0x1a>;
						temperature = <0x1>;
						type = "passive";
					};
				};
			};

			pm7250b-bcl-lvl2 {
				polling-delay = <0x0>;
				polling-delay-passive = <0x64>;
				thermal-sensors = <0x13 0x7>;

				trips {

					b-bcl-lvl2 {
						hysteresis = <0x1>;
						phandle = <0x1b>;
						temperature = <0x1>;
						type = "passive";
					};
				};
			};

			pm7250b-ibat-lvl0 {
				polling-delay = <0x0>;
				polling-delay-passive = <0x0>;
				thermal-sensors = <0x13 0x0>;

				trips {

					ibat-lvl0 {
						hysteresis = <0xc8>;
						phandle = <0x26>;
						temperature = <0x157c>;
						type = "passive";
					};
				};
			};

			pm7250b-ibat-lvl1 {
				polling-delay = <0x0>;
				polling-delay-passive = <0x0>;
				thermal-sensors = <0x13 0x1>;

				trips {

					ibat-lvl1 {
						hysteresis = <0xc8>;
						phandle = <0x27>;
						temperature = <0x1770>;
						type = "passive";
					};
				};
			};

			pm7250b-tz {
				phandle = <0x25>;
				polling-delay = <0x0>;
				polling-delay-passive = <0x64>;
				thermal-sensors = <0x12>;

				trips {

					trip0 {
						hysteresis = <0x0>;
						phandle = <0x16>;
						temperature = <0x17318>;
						type = "passive";
					};

					trip1 {
						hysteresis = <0x0>;
						phandle = <0x17>;
						temperature = <0x1c138>;
						type = "passive";
					};

					trip2 {
						hysteresis = <0x0>;
						temperature = <0x23668>;
						type = "passive";
					};
				};
			};

			socd {
				polling-delay = <0x0>;
				polling-delay-passive = <0x64>;
				thermal-sensors = <0x14>;

				trips {

					soc-trip {
						hysteresis = <0x0>;
						phandle = <0x18>;
						temperature = <0x5a>;
						type = "passive";
					};

					thermal-engine-trip {
						hysteresis = <0x0>;
						temperature = <0x64>;
						type = "passive";
					};

					thermal-hal-trip {
						hysteresis = <0x0>;
						temperature = <0x64>;
						type = "passive";
					};
				};
			};
		};
	};

	fragment@17 {
		target = <0xffffffff>;

		__overlay__ {

			charger-therm-usr {
				polling-delay = <0x0>;
				polling-delay-passive = <0x0>;
				thermal-governor = "user_space";
				thermal-sensors = <0x15 0x0>;
				wake-capable-sensor;

				trips {

					active-config0 {
						hysteresis = <0x3e8>;
						temperature = <0x1e848>;
						type = "passive";
					};
				};
			};

			conn-therm-usr {
				polling-delay = <0x0>;
				polling-delay-passive = <0x0>;
				thermal-governor = "user_space";
				thermal-sensors = <0x15 0x1>;
				wake-capable-sensor;

				trips {

					active-config0 {
						hysteresis = <0x3e8>;
						temperature = <0x1e848>;
						type = "passive";
					};
				};
			};
		};
	};

	fragment@18 {
		target = <0xffffffff>;

		__overlay__ {

			pm7250b-bcl-lvl0 {

				cooling-maps {

					lbat0_cdsp {
						cooling-device = <0xffffffff 0x2 0x2>;
						trip = <0x19>;
					};

					lbat0_cpu6 {
						cooling-device = <0xffffffff 0x1 0x1>;
						trip = <0x19>;
					};

					lbat0_cpu7 {
						cooling-device = <0xffffffff 0x1 0x1>;
						trip = <0x19>;
					};

					lbat0_cpufreq4 {
						cooling-device = <0xffffffff 0x2 0x2>;
						trip = <0x19>;
					};

					lbat0_gpu {
						cooling-device = <0xffffffff 0x2 0x2>;
						trip = <0x19>;
					};
				};
			};

			pm7250b-bcl-lvl1 {

				cooling-maps {

					lbat1_cdsp {
						cooling-device = <0xffffffff 0x4 0x4>;
						trip = <0x1a>;
					};

					lbat1_cpu4 {
						cooling-device = <0xffffffff 0x1 0x1>;
						trip = <0x1a>;
					};

					lbat1_cpu5 {
						cooling-device = <0xffffffff 0x1 0x1>;
						trip = <0x1a>;
					};

					lbat1_gpu {
						cooling-device = <0xffffffff 0x4 0x4>;
						trip = <0x1a>;
					};
				};
			};

			pm7250b-bcl-lvl2 {

				cooling-maps {

					lbat2_cdsp {
						cooling-device = <0xffffffff 0x4 0x4>;
						trip = <0x1b>;
					};

					lbat2_gpu {
						cooling-device = <0xffffffff 0x4 0xffffffff>;
						trip = <0x1b>;
					};
				};
			};

			pm7250b-tz {

				cooling-maps {

					trip0_bat {
						cooling-device = <0x10 0x9 0x9>;
						trip = <0x16>;
					};

					trip1_bat {
						cooling-device = <0x10 0xa 0xa>;
						trip = <0x17>;
					};
				};
			};

			socd {

				cooling-maps {

					soc_cpu4 {
						cooling-device = <0xffffffff 0x1 0x1>;
						trip = <0x18>;
					};

					soc_cpu5 {
						cooling-device = <0xffffffff 0x1 0x1>;
						trip = <0x18>;
					};

					soc_cpu6 {
						cooling-device = <0xffffffff 0x1 0x1>;
						trip = <0x18>;
					};

					soc_cpu7 {
						cooling-device = <0xffffffff 0x1 0x1>;
						trip = <0x18>;
					};
				};
			};
		};
	};

	fragment@19 {
		target = <0xffffffff>;

		__overlay__ {

			qcom,battery-data {
				phandle = <0xd>;
				qcom,batt-id-range-pct = <0xf>;

				qcom,alium_860_89032_0000_3600mAh {
					qcom,batt-id-kohm = <0x6b>;
					qcom,battery-beta = <0x109a>;
					qcom,battery-therm-kohm = <0x64>;
					qcom,battery-type = "Alium_860_89032_0000_3600mAh_Jun15th2018";
					qcom,fastchg-current-ma = <0x1518>;
					qcom,fg-cc-cv-threshold-uv = <0x423920>;
					qcom,jeita-fcc-ranges = <0x0 0x32 0x2625a0 0x33 0x190 0x5265c0 0x191 0x1c2 0x2625a0>;
					qcom,jeita-fv-ranges = <0x0 0x32 0x40d990 0x33 0x190 0x426030 0x191 0x1c2 0x40d990>;
					qcom,jeita-hard-thresholds = <0x58cd 0x20b8>;
					qcom,jeita-soft-fcc-ua = <0x2625a0 0x2625a0>;
					qcom,jeita-soft-fv-uv = <0x40d990 0x40d990>;
					qcom,jeita-soft-hys-thresholds = <0x4f5e 0x2943>;
					qcom,jeita-soft-thresholds = <0x5314 0x25e3>;
					qcom,max-voltage-uv = <0x426030>;
					qcom,ocv-based-step-chg;
					qcom,qg-batt-profile-ver = <0x64>;
					qcom,step-chg-ranges = <0x36ee80 0x39fbc0 0x5265c0 0x39fbc1 0x419ce0 0x36ee80 0x419ce1 0x426030 0x2625a0>;

					qcom,fcc1-temp-lut {
						qcom,lut-col-legend = <0x0 0xa 0x19 0x28 0x32>;
						qcom,lut-data = <0xd62 0xdbf 0xdfd 0xe1d 0xe2e>;
					};

					qcom,fcc2-temp-lut {
						qcom,lut-col-legend = <0xfffffff6 0x0 0xa 0x19 0x28 0x32>;
						qcom,lut-data = <0xdda 0xdf8 0xe02 0xe04 0xdff 0xdff>;
					};

					qcom,pc-temp-v1-lut {
						qcom,lut-col-legend = <0x0 0xa 0x19 0x28 0x32>;
						qcom,lut-data = <0xa846 0xa903 0xa965 0xa982 0xa987 0xa757 0xa82c 0xa88b 0xa8b2 0xa8bc 0xa671 0xa747 0xa7a8 0xa7d4 0xa7e5 0xa598 0xa65f 0xa6c5 0xa6f2 0xa707 0xa4ca 0xa582 0xa5e5 0xa611 0xa627 0xa3ff 0xa4af 0xa508 0xa531 0xa546 0xa330 0xa3e1 0xa430 0xa452 0xa465 0xa25d 0xa311 0xa35c 0xa377 0xa387 0xa1a0 0xa23e 0xa287 0xa29e 0xa2ad 0xa10a 0xa17a 0xa1b1 0xa1c4 0xa1d2 0xa07e 0xa0e5 0xa0f6 0xa0f5 0xa0fc 0x9fa9 0xa061 0xa067 0xa048 0xa036 0x9e4b 0x9f9a 0x9fd6 0x9fae 0x9f81 0x9cdb 0x9e3d 0x9ee8 0x9ee6 0x9ebf 0x9bed 0x9cd1 0x9d85 0x9dc6 0x9dd7 0x9b4d 0x9bf5 0x9c67 0x9cb4 0x9cf4 0x9ad6 0x9b65 0x9bd6 0x9c18 0x9c4a 0x9a75 0x9af5 0x9b63 0x9baa 0x9bc5 0x9a1f 0x9a9b 0x9ade 0x9b13 0x9b23 0x99c4 0x9a41 0x9a3f 0x9a2d 0x9a41 0x9962 0x99c6 0x998a 0x9943 0x9959 0x98fd 0x992a 0x98b8 0x9892 0x98a0 0x9894 0x9882 0x97f4 0x9800 0x9807 0x982b 0x97c6 0x976f 0x9780 0x9781 0x97cb 0x9713 0x970f 0x970c 0x970c 0x9775 0x9697 0x96b5 0x96a2 0x96a2 0x9724 0x963e 0x965a 0x9642 0x963e 0x96db 0x95fa 0x9603 0x95e9 0x95e1 0x9698 0x95c7 0x95b7 0x9598 0x958b 0x965b 0x959d 0x9571 0x954e 0x953b 0x9627 0x9575 0x9533 0x950c 0x94f4 0x95f8 0x9550 0x94fe 0x94d1 0x94b3 0x95cc 0x952e 0x94cf 0x949b 0x947a 0x95a2 0x9511 0x94a4 0x9465 0x9440 0x9579 0x94f7 0x947f 0x9432 0x9407 0x954f 0x94d6 0x9458 0x93fe 0x93cc 0x9525 0x94b2 0x942f 0x93c6 0x938b 0x94f0 0x9484 0x9402 0x938b 0x9345 0x94a6 0x943e 0x93bf 0x9343 0x92f7 0x944c 0x93da 0x935f 0x92ed 0x92a2 0x93e6 0x936c 0x92f1 0x9288 0x923f 0x936b 0x92f1 0x9276 0x920e 0x91c6 0x92e1 0x926f 0x91f1 0x9188 0x9141 0x9248 0x91ea 0x9165 0x90ff 0x90bc 0x91cf 0x9176 0x9100 0x909b 0x905b 0x9179 0x9129 0x90c1 0x9060 0x9022 0x9159 0x910e 0x90ab 0x904f 0x9011 0x913e 0x90f9 0x909a 0x903f 0x9001 0x911a 0x90de 0x907f 0x9020 0x8fdd 0x90ac 0x9070 0x8ff7 0x8f74 0x8f1a 0x8f68 0x8f1c 0x8e9e 0x8e14 0x8db6 0x8d9d 0x8d55 0x8cd8 0x8c4c 0x8beb 0x8b59 0x8b10 0x8a94 0x8a02 0x899f 0x8849 0x87fb 0x877d 0x86e5 0x867d 0x836c 0x8325 0x82aa 0x8209 0x8197 0x7530 0x7530 0x7530 0x7530 0x7530>;
						qcom,lut-row-legend = <0x2710 0x2648 0x2580 0x24b8 0x23f0 0x2328 0x2260 0x2198 0x20d0 0x2008 0x1f40 0x1e78 0x1db0 0x1ce8 0x1c20 0x1b58 0x1a90 0x19c8 0x1900 0x1838 0x1770 0x16a8 0x15e0 0x1518 0x1450 0x1388 0x12c0 0x11f8 0x1130 0x1068 0xfa0 0xed8 0xe10 0xd48 0xc80 0xbb8 0xaf0 0xa28 0x960 0x898 0x7d0 0x708 0x640 0x578 0x4b0 0x3e8 0x384 0x320 0x2bc 0x258 0x1f4 0x190 0x12c 0xc8 0x64 0x0>;
					};

					qcom,pc-temp-v2-lut {
						qcom,lut-col-legend = <0xfffffff6 0x0 0xa 0x19 0x28 0x32>;
						qcom,lut-data = <0xa98d 0xa97e 0xa974 0xa960 0xa92e 0xa910 0xa7fb 0xa83a 0xa854 0xa856 0xa82f 0xa819 0xa6a3 0xa712 0xa747 0xa757 0xa738 0xa728 0xa594 0xa609 0xa64d 0xa665 0xa64a 0xa63c 0xa4c7 0xa51d 0xa566 0xa581 0xa565 0xa558 0xa3f4 0xa43e 0xa489 0xa4a2 0xa484 0xa478 0xa2af 0xa364 0xa3b3 0xa3c8 0xa3a5 0xa397 0xa162 0xa292 0xa2e4 0xa2f3 0xa2ca 0xa2b9 0xa11a 0xa1c1 0xa210 0xa21b 0xa1ef 0xa1de 0xa14f 0xa0ea 0xa131 0xa139 0xa110 0xa103 0xa17a 0xa03c 0xa071 0xa077 0xa047 0xa035 0xa046 0x9fd6 0x9ff5 0x9ff5 0x9fb3 0x9f87 0x9d6d 0x9f7f 0x9f85 0x9f81 0x9f2b 0x9ee2 0x9b88 0x9eab 0x9ea9 0x9ead 0x9e5e 0x9e1a 0x9a81 0x9c78 0x9cde 0x9d1e 0x9d16 0x9d22 0x99b8 0x9a96 0x9b46 0x9bd5 0x9bfe 0x9c3f 0x9913 0x99e8 0x9a78 0x9b4d 0x9b70 0x9b9c 0x9887 0x9977 0x99df 0x9aeb 0x9b04 0x9b0e 0x97f7 0x98f2 0x9948 0x9a53 0x9a64 0x9a58 0x975c 0x9856 0x98b5 0x9965 0x9971 0x9967 0x96c8 0x97b8 0x9827 0x987f 0x9885 0x9883 0x9649 0x9720 0x9799 0x97d3 0x97d8 0x97d6 0x95d8 0x968d 0x9711 0x9743 0x9748 0x9745 0x957d 0x9608 0x9697 0x96c6 0x96cb 0x96c8 0x9533 0x9591 0x9629 0x9658 0x965c 0x9658 0x94f4 0x952a 0x95c3 0x95f3 0x95f6 0x95f1 0x94bc 0x94d6 0x9565 0x9595 0x9598 0x9592 0x948a 0x9491 0x950e 0x953e 0x9540 0x9538 0x9458 0x9459 0x94bd 0x94f0 0x94ef 0x94e6 0x9429 0x942b 0x9471 0x94aa 0x94a5 0x949b 0x93fa 0x9403 0x942c 0x9467 0x9461 0x9456 0x93cb 0x93dc 0x93ed 0x9426 0x9422 0x9418 0x939a 0x93b7 0x93b6 0x93e7 0x93e7 0x93dd 0x9366 0x9390 0x9384 0x93a6 0x93a1 0x9392 0x9330 0x9367 0x935a 0x9364 0x9348 0x932b 0x92f5 0x933c 0x9330 0x9322 0x92ea 0x92bd 0x92b6 0x9309 0x9301 0x92e2 0x9296 0x925d 0x9274 0x92ce 0x92cf 0x92a2 0x9248 0x9208 0x922d 0x9289 0x9294 0x925e 0x91fe 0x91bc 0x91e4 0x9235 0x924a 0x9214 0x91b6 0x9173 0x919a 0x91d4 0x91f2 0x91c0 0x9166 0x9124 0x9151 0x916d 0x918d 0x9158 0x9101 0x90c0 0x910a 0x9104 0x9119 0x90da 0x9085 0x9045 0x90be 0x90a5 0x90a4 0x9064 0x9011 0x8fd4 0x9066 0x9055 0x9058 0x9026 0x8fde 0x8fa3 0x8ff1 0x9009 0x9027 0x900b 0x8fc1 0x8f87 0x8fa0 0x8fd7 0x9010 0x8ff6 0x8fb0 0x8f76 0x8f3a 0x8f9b 0x8ff2 0x8fd7 0x8f94 0x8f5b 0x8e9d 0x8f3c 0x8fa7 0x8f84 0x8f3f 0x8efc 0x8dbc 0x8e73 0x8ecd 0x8e86 0x8e46 0x8df2 0x8c72 0x8d0b 0x8d41 0x8ce7 0x8ca5 0x8c4f 0x8a95 0x8b0d 0x8b2a 0x8ad3 0x8a9a 0x8a45 0x87f8 0x8865 0x887d 0x881c 0x87ec 0x879d 0x841a 0x8496 0x84d3 0x8488 0x847e 0x8426 0x7eca 0x7f24 0x801b 0x8028 0x7f97 0x7ef0 0x6fcb 0x6e6e 0x6d71 0x6d74 0x6d50 0x6d1a>;
						qcom,lut-row-legend = <0x2710 0x2648 0x2580 0x24b8 0x23f0 0x2328 0x2260 0x2198 0x20d0 0x2008 0x1f40 0x1e78 0x1db0 0x1ce8 0x1c20 0x1b58 0x1a90 0x19c8 0x1900 0x1838 0x1770 0x16a8 0x15e0 0x1518 0x1450 0x1388 0x12c0 0x11f8 0x1130 0x1068 0xfa0 0xed8 0xe10 0xd48 0xc80 0xbb8 0xaf0 0xa28 0x960 0x898 0x7d0 0x708 0x640 0x578 0x4b0 0x3e8 0x384 0x320 0x2bc 0x258 0x1f4 0x190 0x12c 0xc8 0x64 0x0>;
					};

					qcom,pc-temp-y1-lut {
						qcom,lut-col-legend = <0xfffffff6 0x0 0xa 0x19 0x28 0x32>;
						qcom,lut-data = <0x1dae 0x1a6c 0x17b7 0x1540 0x1467 0x143b 0x1db4 0x1a6f 0x17c3 0x153f 0x1466 0x143d 0x1dc0 0x1a74 0x17ca 0x153e 0x1466 0x143e 0x1dcd 0x1a7a 0x17ce 0x153c 0x1466 0x1440 0x1dd8 0x1a7e 0x17d0 0x153b 0x1467 0x1441 0x1ddd 0x1a80 0x17d0 0x153a 0x1467 0x1443 0x1ddc 0x1a80 0x17cc 0x153a 0x1468 0x1443 0x1dda 0x1a80 0x17c6 0x153a 0x146a 0x1444 0x1dd3 0x1a7d 0x17c5 0x153b 0x146c 0x1445 0x1dbc 0x1a76 0x17c8 0x153c 0x146d 0x1446 0x1daa 0x1a70 0x17ca 0x153d 0x146f 0x1448 0x1db3 0x1a6e 0x17c6 0x153d 0x1470 0x1449 0x1dc8 0x1a6f 0x17c0 0x153d 0x1472 0x144b 0x1ddc 0x1a74 0x17c1 0x153e 0x1474 0x144d 0x1df4 0x1a85 0x17d0 0x1545 0x1479 0x1452 0x1e03 0x1a97 0x17db 0x154d 0x147c 0x1454 0x1dfa 0x1aa4 0x17df 0x154f 0x147c 0x1455 0x1de7 0x1aaf 0x17e3 0x1552 0x147d 0x1455 0x1dd8 0x1ab0 0x17e4 0x1554 0x147e 0x1456 0x1dca 0x1aa1 0x17e2 0x1555 0x1480 0x1459 0x1dc3 0x1a95 0x17e2 0x1558 0x1483 0x145c 0x1dd6 0x1a97 0x17ed 0x155c 0x1487 0x1460 0x1df9 0x1a9f 0x17fb 0x1560 0x148b 0x1463 0x1e01 0x1aa5 0x17fd 0x1565 0x148e 0x1467 0x1e00 0x1aa8 0x17f8 0x1569 0x1491 0x146a 0x1e04 0x1aac 0x17f7 0x156d 0x1493 0x146e 0x1e09 0x1ab8 0x1800 0x1571 0x1496 0x1472 0x1e0c 0x1acc 0x180b 0x1576 0x149a 0x1475 0x1e0a 0x1ad7 0x180e 0x157b 0x149d 0x1478 0x1df8 0x1adc 0x1812 0x1581 0x14a0 0x147a 0x1de0 0x1ade 0x1817 0x1586 0x14a3 0x147d 0x1dd9 0x1adb 0x181b 0x158b 0x14a7 0x1480 0x1ddb 0x1ad7 0x181f 0x1590 0x14aa 0x1484 0x1ddd 0x1ad7 0x1820 0x1593 0x14ad 0x1487 0x1de1 0x1ad5 0x1821 0x1596 0x14b0 0x1489 0x1de8 0x1ad3 0x1823 0x1599 0x14b2 0x148b 0x1df7 0x1adf 0x1827 0x159b 0x14b4 0x148c 0x1e0a 0x1aef 0x182c 0x159d 0x14b5 0x148d 0x1e0d 0x1aef 0x1831 0x159e 0x14b5 0x148e 0x1dff 0x1ae3 0x1835 0x159f 0x14b6 0x148e 0x1df5 0x1adf 0x183a 0x15a1 0x14b7 0x148f 0x1df6 0x1ae5 0x1841 0x15a5 0x14b9 0x1491 0x1df6 0x1aeb 0x184c 0x15a8 0x14ba 0x1492 0x1df6 0x1af2 0x1849 0x15aa 0x14bb 0x1493 0x1dfa 0x1af8 0x1850 0x15af 0x14be 0x1495 0x1e04 0x1b0b 0x1850 0x15b1 0x14be 0x1496 0x1e09 0x1b08 0x1859 0x15b4 0x14be 0x1496 0x1e26 0x1b0e 0x1863 0x15b4 0x14be 0x1496 0x1e37 0x1b0b 0x186b 0x15b6 0x14bf 0x1496 0x1e2c 0x1b1e 0x1867 0x15b9 0x14c2 0x1498 0x1e29 0x1b3f 0x1879 0x15c2 0x14c5 0x149b 0x1e38 0x1b5b 0x1895 0x15d1 0x14cc 0x14a0 0x1e61 0x1b5f 0x18a8 0x15e4 0x14d3 0x14a6 0x1eb6 0x1b7e 0x18ca 0x15f7 0x14dc 0x14ac 0x1eb6 0x1b7e 0x18ca 0x15f7 0x14dc 0x14ac 0x1eb6 0x1b7e 0x18ca 0x15f7 0x14dc 0x14ac>;
						qcom,lut-row-legend = <0x2710 0x2648 0x2580 0x24b8 0x23f0 0x2328 0x2260 0x2198 0x20d0 0x2008 0x1f40 0x1e78 0x1db0 0x1ce8 0x1c20 0x1b58 0x1a90 0x19c8 0x1900 0x1838 0x1770 0x16a8 0x15e0 0x1518 0x1450 0x1388 0x12c0 0x11f8 0x1130 0x1068 0xfa0 0xed8 0xe10 0xd48 0xc80 0xbb8 0xaf0 0xa28 0x960 0x898 0x7d0 0x708 0x640 0x578 0x4b0 0x3e8 0x384 0x320 0x2bc 0x258 0x1f4 0x190 0x12c 0xc8 0x64 0x0>;
					};

					qcom,pc-temp-y2-lut {
						qcom,lut-col-legend = <0xfffffff6 0x0 0xa 0x19 0x28 0x32>;
						qcom,lut-data = <0x25d6 0x28a1 0x29b8 0x2b2a 0x2b60 0x2c89 0x2638 0x287f 0x299b 0x2b15 0x2b62 0x2c51 0x2674 0x286a 0x297a 0x2afb 0x2b61 0x2bfc 0x2693 0x285f 0x2959 0x2ade 0x2b5e 0x2ba2 0x269f 0x285b 0x293d 0x2abd 0x2b58 0x2b5a 0x26a2 0x285a 0x292b 0x2a9a 0x2b51 0x2b3c 0x266c 0x2867 0x2922 0x2a6d 0x2b48 0x2b43 0x260b 0x287d 0x291b 0x2a3f 0x2b3b 0x2b4e 0x25f2 0x2878 0x2916 0x2a29 0x2b28 0x2b4d 0x25fe 0x283e 0x2912 0x2a1c 0x2b09 0x2b3a 0x2615 0x2814 0x2910 0x2a13 0x2ae5 0x2b24 0x2698 0x2862 0x291a 0x2a04 0x2ab6 0x2afb 0x2784 0x28ea 0x2933 0x29f0 0x2a85 0x2ac3 0x27ba 0x2909 0x295a 0x29f2 0x2a7a 0x2abc 0x26d8 0x28f6 0x29a8 0x2a1d 0x2a90 0x2af0 0x2601 0x28e9 0x29e0 0x2a53 0x2ab0 0x2b19 0x25e5 0x28ff 0x29fa 0x2a91 0x2aec 0x2b1b 0x25de 0x2924 0x2a0e 0x2ad0 0x2b33 0x2b18 0x25d8 0x292d 0x2a1d 0x2aef 0x2b47 0x2b23 0x25d2 0x292c 0x2a2b 0x2afc 0x2b48 0x2b59 0x25cd 0x2929 0x2a36 0x2b0a 0x2b4a 0x2b9b 0x25ca 0x28f3 0x2a3f 0x2b29 0x2b78 0x2bd9 0x25c8 0x2849 0x2a48 0x2b54 0x2bc0 0x2c13 0x25c6 0x27d1 0x2a4b 0x2b74 0x2be2 0x2c3d 0x25c3 0x275f 0x2a50 0x2b8f 0x2bf6 0x2c5c 0x25c0 0x271c 0x2a54 0x2ba1 0x2c07 0x2c71 0x25bf 0x270e 0x2a52 0x2bac 0x2c19 0x2c83 0x25be 0x2700 0x2a4a 0x2bb0 0x2c2d 0x2c96 0x25bd 0x26ed 0x2a46 0x2ba7 0x2c35 0x2cb5 0x25bc 0x26d4 0x2a44 0x2b8e 0x2c41 0x2cec 0x25bb 0x26b9 0x2a3f 0x2b80 0x2c4d 0x2d11 0x25bb 0x26a1 0x29e9 0x2b83 0x2c40 0x2d02 0x25ba 0x268b 0x294e 0x2b8f 0x2c2f 0x2cda 0x25b9 0x2672 0x290b 0x2b9c 0x2c33 0x2cca 0x25b8 0x2655 0x28fa 0x2b99 0x2c39 0x2cd1 0x25b8 0x263a 0x28ee 0x2b84 0x2c35 0x2cd6 0x25b7 0x2622 0x28e6 0x2b68 0x2c34 0x2cdc 0x25b7 0x2604 0x290b 0x2b59 0x2c39 0x2ce8 0x25b6 0x25ec 0x293c 0x2b5f 0x2c3b 0x2ce7 0x25b6 0x25de 0x291d 0x2b60 0x2c36 0x2cd1 0x25b6 0x25d4 0x28ba 0x2b5f 0x2c32 0x2cc5 0x25b6 0x25cb 0x289c 0x2b62 0x2c34 0x2ccc 0x25b6 0x25c4 0x28a6 0x2b5d 0x2c32 0x2ccf 0x25b5 0x25be 0x281b 0x2b46 0x2c13 0x2cc8 0x25b5 0x25bb 0x27d7 0x2b34 0x2c13 0x2cb0 0x25b5 0x25bb 0x27c4 0x2b11 0x2c20 0x2c82 0x25b5 0x25ba 0x2810 0x2b0d 0x2c0a 0x2c51 0x25b5 0x25b9 0x2851 0x2b23 0x2be8 0x2c48 0x25b5 0x25b8 0x2853 0x2b28 0x2bef 0x2c50 0x25b4 0x25b8 0x2837 0x2ae6 0x2c1e 0x2c3a 0x25b4 0x25b6 0x2800 0x2acc 0x2bf7 0x2bfd 0x25b4 0x25b5 0x27bc 0x2aa1 0x2b7e 0x2ba7 0x25b4 0x25b4 0x2786 0x2a49 0x2b0f 0x2b35 0x25b2 0x25b4 0x2773 0x2a1c 0x2a4f 0x2a4a 0x25b2 0x25b4 0x2773 0x2a1c 0x2a4f 0x2a4a 0x25b2 0x25b4 0x2773 0x2a1c 0x2a4f 0x2a4a>;
						qcom,lut-row-legend = <0x2710 0x2648 0x2580 0x24b8 0x23f0 0x2328 0x2260 0x2198 0x20d0 0x2008 0x1f40 0x1e78 0x1db0 0x1ce8 0x1c20 0x1b58 0x1a90 0x19c8 0x1900 0x1838 0x1770 0x16a8 0x15e0 0x1518 0x1450 0x1388 0x12c0 0x11f8 0x1130 0x1068 0xfa0 0xed8 0xe10 0xd48 0xc80 0xbb8 0xaf0 0xa28 0x960 0x898 0x7d0 0x708 0x640 0x578 0x4b0 0x3e8 0x384 0x320 0x2bc 0x258 0x1f4 0x190 0x12c 0xc8 0x64 0x0>;
					};

					qcom,pc-temp-y3-lut {
						qcom,lut-col-legend = <0xfffffff6 0x0 0xa 0x19 0x28 0x32>;
						qcom,lut-data = <0x347a 0x3456 0x3421 0x33e5 0x33e0 0x33d8 0x356b 0x345f 0x341a 0x33e4 0x33e0 0x33da 0x35ff 0x346c 0x3416 0x33e3 0x33e0 0x33db 0x364d 0x3479 0x3416 0x33e3 0x33e0 0x33dd 0x366b 0x3484 0x3418 0x33e3 0x33e0 0x33de 0x3670 0x3489 0x341c 0x33e5 0x33e0 0x33de 0x35ec 0x3489 0x3423 0x33e8 0x33e0 0x33de 0x34fc 0x3488 0x342b 0x33ed 0x33e1 0x33de 0x34bb 0x348b 0x342e 0x33ef 0x33e1 0x33de 0x34ba 0x349e 0x342f 0x33f0 0x33e1 0x33dd 0x34bb 0x34ac 0x3430 0x33f0 0x33e1 0x33dd 0x34d3 0x349e 0x343d 0x33f7 0x33e4 0x33df 0x3504 0x3481 0x3450 0x3401 0x33e9 0x33e2 0x3510 0x3471 0x3451 0x3402 0x33ea 0x33e3 0x34ec 0x3468 0x343b 0x33fe 0x33e8 0x33e2 0x34cc 0x3462 0x3427 0x33fb 0x33e6 0x33e2 0x34d0 0x345f 0x3422 0x33fd 0x33e8 0x33e2 0x34e0 0x345d 0x341f 0x3401 0x33ec 0x33e3 0x34e7 0x345a 0x341b 0x3401 0x33ec 0x33e3 0x34e9 0x3455 0x3416 0x33f9 0x33e7 0x33e0 0x34ea 0x344f 0x3411 0x33f0 0x33e3 0x33dd 0x34ec 0x3445 0x340c 0x33e8 0x33e1 0x33dc 0x34f0 0x3435 0x3407 0x33e3 0x33e0 0x33db 0x34f5 0x3427 0x3406 0x33e2 0x33df 0x33db 0x3500 0x341c 0x3405 0x33e3 0x33de 0x33db 0x3512 0x3417 0x3405 0x33e4 0x33de 0x33da 0x3525 0x3418 0x3405 0x33e3 0x33de 0x33da 0x3539 0x341b 0x3405 0x33e3 0x33dd 0x33da 0x354f 0x341f 0x3405 0x33e5 0x33dd 0x33da 0x356b 0x3423 0x3405 0x33e9 0x33dd 0x33d9 0x358d 0x3428 0x3405 0x33ec 0x33dd 0x33d9 0x35b2 0x342d 0x3400 0x33ed 0x33de 0x33d9 0x35da 0x3434 0x33f9 0x33ec 0x33de 0x33da 0x360a 0x343c 0x33f6 0x33ec 0x33df 0x33da 0x3641 0x3449 0x33f7 0x33ea 0x33de 0x33da 0x3680 0x3458 0x33f8 0x33e8 0x33de 0x33d9 0x36c1 0x3468 0x33fb 0x33e6 0x33de 0x33d9 0x3702 0x347a 0x3402 0x33e4 0x33dd 0x33d9 0x3742 0x3490 0x3408 0x33e3 0x33dd 0x33d9 0x3781 0x34b0 0x340c 0x33e3 0x33dd 0x33d9 0x37c1 0x34dc 0x340f 0x33e3 0x33dd 0x33d9 0x3803 0x3511 0x3415 0x33e3 0x33de 0x33da 0x3845 0x3550 0x341e 0x33e3 0x33de 0x33da 0x3892 0x35a3 0x3421 0x33e4 0x33de 0x33da 0x38ea 0x3613 0x3429 0x33e3 0x33de 0x33da 0x390d 0x3642 0x3430 0x33eb 0x33df 0x33dc 0x393f 0x363e 0x3435 0x33ec 0x33e1 0x33dd 0x395c 0x3658 0x3442 0x33f0 0x33e3 0x33e0 0x398d 0x36b9 0x3451 0x33f2 0x33e2 0x33e0 0x3a0b 0x3718 0x3452 0x33ee 0x33e1 0x33dd 0x3a97 0x37a6 0x345a 0x33f0 0x33e0 0x33dd 0x3b31 0x3888 0x346f 0x33f5 0x33e3 0x33e1 0x3c10 0x3978 0x3492 0x33f9 0x33e6 0x33e4 0x3f2c 0x3a7b 0x34ca 0x3403 0x33ea 0x33e6 0x3f2c 0x3a7b 0x34ca 0x3403 0x33ea 0x33e6 0x3f2c 0x3a7b 0x34ca 0x3403 0x33ea 0x33e6>;
						qcom,lut-row-legend = <0x2710 0x2648 0x2580 0x24b8 0x23f0 0x2328 0x2260 0x2198 0x20d0 0x2008 0x1f40 0x1e78 0x1db0 0x1ce8 0x1c20 0x1b58 0x1a90 0x19c8 0x1900 0x1838 0x1770 0x16a8 0x15e0 0x1518 0x1450 0x1388 0x12c0 0x11f8 0x1130 0x1068 0xfa0 0xed8 0xe10 0xd48 0xc80 0xbb8 0xaf0 0xa28 0x960 0x898 0x7d0 0x708 0x640 0x578 0x4b0 0x3e8 0x384 0x320 0x2bc 0x258 0x1f4 0x190 0x12c 0xc8 0x64 0x0>;
					};

					qcom,pc-temp-y4-lut {
						qcom,lut-col-legend = <0xfffffff6 0x0 0xa 0x19 0x28 0x32>;
						qcom,lut-data = <0x45b5 0x41d2 0x40f2 0x406d 0x4045 0x4044 0x452b 0x41db 0x40ef 0x4073 0x4045 0x4042 0x44eb 0x41eb 0x40ef 0x4078 0x4047 0x4041 0x44e9 0x4200 0x40f2 0x407b 0x4048 0x4040 0x4515 0x421b 0x40f7 0x407d 0x404a 0x4040 0x4561 0x4239 0x40fe 0x407e 0x404b 0x4040 0x4627 0x4263 0x4106 0x407c 0x404d 0x4041 0x478b 0x428e 0x4111 0x407a 0x404e 0x4044 0x4914 0x42a4 0x411c 0x407a 0x4051 0x4046 0x4b24 0x42ad 0x4127 0x4081 0x4055 0x4049 0x4c74 0x42bc 0x4138 0x408c 0x405b 0x404d 0x4a3e 0x4407 0x419f 0x409e 0x4069 0x4059 0x4560 0x4626 0x4237 0x40b4 0x407d 0x4068 0x437a 0x4642 0x4251 0x40bd 0x4081 0x406c 0x4347 0x43a8 0x4203 0x40bf 0x407d 0x406b 0x432d 0x41b1 0x41aa 0x40c3 0x407b 0x406a 0x4320 0x41b5 0x416e 0x40ec 0x4091 0x407a 0x430d 0x41e2 0x413b 0x4129 0x40ba 0x4098 0x42ef 0x41ed 0x4117 0x412a 0x40c0 0x409d 0x42b4 0x41c5 0x40fa 0x40d1 0x4094 0x407d 0x4274 0x4198 0x40e3 0x4085 0x4066 0x405b 0x4249 0x4180 0x40d4 0x4078 0x4054 0x404d 0x4228 0x416e 0x40c8 0x4072 0x4049 0x4043 0x421f 0x416b 0x40c2 0x406f 0x4048 0x4042 0x4223 0x415f 0x40be 0x406b 0x4048 0x4042 0x422b 0x414f 0x40bb 0x4069 0x4049 0x4043 0x4231 0x4143 0x40ba 0x406b 0x404b 0x4045 0x423b 0x4137 0x40ba 0x406d 0x404e 0x4048 0x4246 0x4136 0x40b9 0x406e 0x4051 0x404c 0x4252 0x4142 0x40b4 0x4070 0x4057 0x4051 0x425e 0x4154 0x40b0 0x4072 0x405e 0x4058 0x426a 0x4167 0x40b4 0x4074 0x4068 0x4063 0x4276 0x417f 0x40bd 0x4076 0x4073 0x4070 0x4283 0x4198 0x40c4 0x4074 0x4075 0x4072 0x4290 0x41b2 0x40c9 0x4069 0x4064 0x4061 0x429c 0x41cd 0x40cd 0x405e 0x404f 0x404c 0x42a8 0x41ef 0x40d2 0x405b 0x4044 0x4043 0x42b5 0x421f 0x40d8 0x4059 0x403e 0x403f 0x42c7 0x4244 0x40dc 0x405a 0x403e 0x4040 0x42e1 0x4252 0x40e9 0x405d 0x4042 0x4045 0x4308 0x425c 0x40fd 0x4060 0x4047 0x404a 0x433b 0x4262 0x410c 0x4063 0x4048 0x404b 0x437e 0x4270 0x4118 0x4064 0x4046 0x4048 0x43d3 0x4287 0x4129 0x4061 0x403d 0x403b 0x442a 0x42c2 0x4147 0x406b 0x4041 0x403e 0x441b 0x42ef 0x4160 0x4075 0x4057 0x405a 0x441e 0x4307 0x4166 0x4084 0x4070 0x4078 0x43ed 0x432a 0x4193 0x40a2 0x4099 0x40a2 0x43d0 0x436e 0x41e6 0x40be 0x409c 0x4098 0x43e5 0x4383 0x41de 0x409e 0x406e 0x4064 0x43f6 0x4384 0x41d8 0x409e 0x4060 0x4059 0x4411 0x43a0 0x41fb 0x40bd 0x4070 0x4067 0x4463 0x43f1 0x4266 0x40fb 0x4090 0x4085 0x470a 0x44a2 0x432d 0x41de 0x4141 0x4118 0x470a 0x44a2 0x432d 0x41de 0x4141 0x4118 0x470a 0x44a2 0x432d 0x41de 0x4141 0x4118>;
						qcom,lut-row-legend = <0x2710 0x2648 0x2580 0x24b8 0x23f0 0x2328 0x2260 0x2198 0x20d0 0x2008 0x1f40 0x1e78 0x1db0 0x1ce8 0x1c20 0x1b58 0x1a90 0x19c8 0x1900 0x1838 0x1770 0x16a8 0x15e0 0x1518 0x1450 0x1388 0x12c0 0x11f8 0x1130 0x1068 0xfa0 0xed8 0xe10 0xd48 0xc80 0xbb8 0xaf0 0xa28 0x960 0x898 0x7d0 0x708 0x640 0x578 0x4b0 0x3e8 0x384 0x320 0x2bc 0x258 0x1f4 0x190 0x12c 0xc8 0x64 0x0>;
					};

					qcom,pc-temp-y5-lut {
						qcom,lut-col-legend = <0xfffffff6 0x0 0xa 0x19 0x28 0x32>;
						qcom,lut-data = <0x2208 0x348a 0x3ab0 0x3545 0x4573 0x3634 0x2208 0x34aa 0x3839 0x3326 0x4393 0x3e82 0x269f 0x34e2 0x3660 0x31db 0x419b 0x43da 0x2f8b 0x3522 0x3519 0x3130 0x3fbf 0x46e0 0x3428 0x3557 0x345a 0x30f0 0x3e34 0x4838 0x3590 0x3572 0x341a 0x30e7 0x3d2f 0x4884 0x30ee 0x3576 0x34b3 0x32d3 0x3ca4 0x46c7 0x2869 0x3578 0x35a4 0x35e5 0x3c3f 0x4385 0x267f 0x34b6 0x35c2 0x3648 0x3b81 0x4119 0x2a54 0x3032 0x3545 0x34d0 0x3996 0x3e92 0x2ff6 0x2cf8 0x3494 0x33cf 0x387f 0x3ce5 0x37e1 0x2fd6 0x333d 0x3525 0x3964 0x3cfd 0x4112 0x360e 0x319c 0x3768 0x3acb 0x3dbd 0x4280 0x3a64 0x326c 0x37dc 0x3b0d 0x3dbf 0x373b 0x3dd4 0x395e 0x3745 0x3a7a 0x3cb2 0x2cf9 0x3f72 0x3eca 0x36d1 0x3a41 0x3bb0 0x2d03 0x3ec5 0x3f83 0x384b 0x3ae8 0x3b5d 0x2edc 0x3dc2 0x3fc3 0x3b9d 0x3c38 0x3b2b 0x2f8c 0x3d9a 0x3f92 0x3dc7 0x3e57 0x3b93 0x2f1e 0x3df3 0x3ecf 0x3f34 0x4225 0x3e9f 0x2e5c 0x3e54 0x3de6 0x3fc8 0x445b 0x4233 0x2d64 0x3c6d 0x3c08 0x3c17 0x4527 0x44e0 0x2c30 0x3697 0x3971 0x3578 0x4604 0x471b 0x2b6b 0x3248 0x38a0 0x33d2 0x4627 0x47ff 0x2b06 0x2f1a 0x38d8 0x353a 0x4512 0x484d 0x2ad4 0x2d6f 0x3925 0x3660 0x43d2 0x484f 0x2add 0x2d4c 0x3975 0x3678 0x4315 0x4790 0x2aec 0x2d55 0x39cc 0x366c 0x4294 0x45bc 0x2af3 0x2d44 0x3a34 0x38ed 0x427b 0x43ff 0x2b16 0x2d12 0x3b09 0x40ee 0x4270 0x426f 0x2b4e 0x2d07 0x3ba6 0x465a 0x4280 0x41aa 0x2b80 0x2d07 0x38cb 0x47e5 0x43ef 0x42bb 0x2ba9 0x2cec 0x3382 0x48db 0x472c 0x45f6 0x2bd0 0x2ce9 0x319e 0x48b8 0x4a98 0x495f 0x2bf8 0x2d41 0x31a4 0x45bb 0x4e8c 0x4c69 0x2c20 0x2daa 0x31b5 0x4185 0x51da 0x4ea9 0x2c45 0x2dd9 0x3221 0x3e14 0x52fb 0x508e 0x2c64 0x2d8a 0x34af 0x3aee 0x5257 0x524a 0x2c6c 0x2d32 0x3713 0x3918 0x50bc 0x5292 0x2c5a 0x2d52 0x36de 0x38bf 0x4e90 0x50e7 0x2c45 0x2d99 0x34f7 0x3913 0x4dbc 0x4f8f 0x2c53 0x2da9 0x354f 0x3906 0x4ea8 0x5136 0x2cb7 0x2d71 0x370b 0x3898 0x515e 0x56c7 0x2d6c 0x2d2c 0x33cd 0x3962 0x555b 0x5c52 0x2e6e 0x2cc8 0x325a 0x3610 0x4cc2 0x4ea4 0x2fc4 0x2d10 0x320a 0x3e49 0x4394 0x4373 0x30b0 0x2d1b 0x3431 0x3e08 0x42cc 0x40b6 0x322c 0x2e86 0x370e 0x4092 0x40be 0x3f21 0x3256 0x3099 0x3915 0x3fe1 0x3e27 0x3e5b 0x322c 0x3127 0x38b1 0x3e5f 0x428d 0x410e 0x3117 0x3039 0x38e1 0x4283 0x4414 0x4431 0x2f77 0x2f18 0x37f8 0x4528 0x4741 0x4a06 0x2e6f 0x2e5e 0x37ca 0x4396 0x477b 0x4ab1 0x2b65 0x2d9d 0x3932 0x4343 0x45a6 0x476b 0x2b65 0x2d9d 0x3932 0x4343 0x45a6 0x476b 0x2b65 0x2d9d 0x3932 0x4343 0x45a6 0x476b>;
						qcom,lut-row-legend = <0x2710 0x2648 0x2580 0x24b8 0x23f0 0x2328 0x2260 0x2198 0x20d0 0x2008 0x1f40 0x1e78 0x1db0 0x1ce8 0x1c20 0x1b58 0x1a90 0x19c8 0x1900 0x1838 0x1770 0x16a8 0x15e0 0x1518 0x1450 0x1388 0x12c0 0x11f8 0x1130 0x1068 0xfa0 0xed8 0xe10 0xd48 0xc80 0xbb8 0xaf0 0xa28 0x960 0x898 0x7d0 0x708 0x640 0x578 0x4b0 0x3e8 0x384 0x320 0x2bc 0x258 0x1f4 0x190 0x12c 0xc8 0x64 0x0>;
					};

					qcom,pc-temp-y6-lut {
						qcom,lut-col-legend = <0xfffffff6 0x0 0xa 0x19 0x28 0x32>;
						qcom,lut-data = <0x1af4 0x1607 0x1492 0x13c9 0x139d 0x1392 0x1afb 0x160e 0x148d 0x13c8 0x139d 0x1393 0x1aff 0x1616 0x148a 0x13c7 0x139d 0x1394 0x1aff 0x161e 0x148a 0x13c8 0x139d 0x1395 0x1afc 0x1626 0x148c 0x13c9 0x139e 0x1395 0x1af7 0x162e 0x148e 0x13ca 0x139f 0x1396 0x1ac7 0x1636 0x1494 0x13cc 0x139f 0x1397 0x1a78 0x163e 0x149c 0x13cf 0x13a1 0x1397 0x1a74 0x1646 0x14a1 0x13d2 0x13a2 0x1398 0x1aff 0x164c 0x14a3 0x13d4 0x13a3 0x1399 0x1b70 0x1657 0x14a8 0x13d7 0x13a5 0x139a 0x1af4 0x16ac 0x14cc 0x13e2 0x13ac 0x139f 0x19d3 0x172c 0x1503 0x13ef 0x13b5 0x13a6 0x1941 0x172c 0x150b 0x13f2 0x13b7 0x13a8 0x190e 0x1670 0x14e5 0x13f1 0x13b5 0x13a7 0x18f6 0x15e2 0x14be 0x13f0 0x13b3 0x13a7 0x18fb 0x15e4 0x14ab 0x13fd 0x13bb 0x13ac 0x1909 0x15f5 0x149c 0x1412 0x13c9 0x13b5 0x190d 0x15f9 0x148f 0x1412 0x13cb 0x13b7 0x190c 0x15ed 0x1483 0x13f3 0x13bb 0x13ab 0x190a 0x15e0 0x147a 0x13d6 0x13ab 0x139f 0x190d 0x15d6 0x1473 0x13cd 0x13a4 0x139a 0x191a 0x15ce 0x146e 0x13c8 0x13a1 0x1397 0x192c 0x15c9 0x146d 0x13c7 0x13a0 0x1397 0x1945 0x15c7 0x146e 0x13c7 0x13a0 0x1397 0x1964 0x15c6 0x146f 0x13c8 0x13a0 0x1398 0x1982 0x15cb 0x1470 0x13c9 0x13a1 0x1398 0x19a0 0x15d5 0x1473 0x13ca 0x13a2 0x1399 0x19c0 0x15e2 0x1475 0x13cc 0x13a3 0x139a 0x19e6 0x15f3 0x1476 0x13d0 0x13a5 0x139c 0x1a11 0x1607 0x1477 0x13d4 0x13a7 0x139e 0x1a3f 0x161d 0x1478 0x13d6 0x13ab 0x13a2 0x1a72 0x1638 0x1479 0x13d7 0x13af 0x13a6 0x1aa7 0x1655 0x147b 0x13d6 0x13b0 0x13a7 0x1ae0 0x1676 0x147f 0x13d2 0x13ab 0x13a2 0x1b1c 0x169b 0x1483 0x13ce 0x13a5 0x139c 0x1b59 0x16c6 0x1488 0x13cc 0x13a2 0x139a 0x1b96 0x16f8 0x1490 0x13cb 0x13a0 0x1398 0x1bd4 0x1732 0x149a 0x13ca 0x13a0 0x1399 0x1c13 0x1772 0x14a5 0x13cb 0x13a1 0x139a 0x1c51 0x17bc 0x14b0 0x13cd 0x13a3 0x139c 0x1c90 0x1811 0x14bf 0x13ce 0x13a4 0x139d 0x1cd3 0x1875 0x14d0 0x13cf 0x13a3 0x139c 0x1d22 0x18ef 0x14e0 0x13d0 0x13a1 0x1399 0x1d80 0x1984 0x14f9 0x13d2 0x13a3 0x139a 0x1da5 0x19b9 0x150c 0x13db 0x13a9 0x13a3 0x1dcf 0x19c4 0x1513 0x13e1 0x13b2 0x13ad 0x1dde 0x19e7 0x152f 0x13ec 0x13bf 0x13bb 0x1e04 0x1a57 0x155a 0x13f6 0x13c0 0x13b8 0x1e6d 0x1abf 0x1560 0x13eb 0x13b2 0x13a7 0x1edf 0x1b41 0x1573 0x13ee 0x13ae 0x13a5 0x1f66 0x1c0d 0x15ab 0x13fd 0x13b6 0x13ac 0x2034 0x1cdf 0x160e 0x1415 0x13c2 0x13b7 0x23c8 0x1de5 0x16a3 0x1461 0x13f8 0x13e4 0x23c8 0x1de5 0x16a3 0x1461 0x13f8 0x13e4 0x23c8 0x1de5 0x16a3 0x1461 0x13f8 0x13e4>;
						qcom,lut-row-legend = <0x2710 0x2648 0x2580 0x24b8 0x23f0 0x2328 0x2260 0x2198 0x20d0 0x2008 0x1f40 0x1e78 0x1db0 0x1ce8 0x1c20 0x1b58 0x1a90 0x19c8 0x1900 0x1838 0x1770 0x16a8 0x15e0 0x1518 0x1450 0x1388 0x12c0 0x11f8 0x1130 0x1068 0xfa0 0xed8 0xe10 0xd48 0xc80 0xbb8 0xaf0 0xa28 0x960 0x898 0x7d0 0x708 0x640 0x578 0x4b0 0x3e8 0x384 0x320 0x2bc 0x258 0x1f4 0x190 0x12c 0xc8 0x64 0x0>;
					};

					qcom,pc-temp-z1-lut {
						qcom,lut-col-legend = <0x0 0xa 0x19 0x28 0x32>;
						qcom,lut-data = <0x38d1 0x33b6 0x2f09 0x2da0 0x2d49 0x38bb 0x337f 0x2f0d 0x2d9e 0x2d52 0x38c3 0x3376 0x2f0b 0x2da5 0x2d5c 0x38c7 0x337e 0x2f07 0x2da7 0x2d60 0x38d3 0x3382 0x2f03 0x2da8 0x2d62 0x38eb 0x337d 0x2f01 0x2da8 0x2d64 0x38ff 0x336c 0x2f02 0x2da9 0x2d67 0x38f6 0x335e 0x2f03 0x2dac 0x2d6a 0x38d7 0x335d 0x2f05 0x2dae 0x2d6d 0x38b6 0x3362 0x2f09 0x2db1 0x2d6f 0x3896 0x3360 0x2f0d 0x2db5 0x2d72 0x3874 0x334e 0x2f0f 0x2db8 0x2d77 0x3843 0x333c 0x2f0f 0x2dbb 0x2d7b 0x3810 0x332e 0x2f0b 0x2dbb 0x2d7c 0x37ee 0x3328 0x2f04 0x2db9 0x2d7c 0x37d3 0x3329 0x2f01 0x2db7 0x2d7c 0x37b6 0x3329 0x2f04 0x2dbb 0x2d7f 0x3792 0x332c 0x2f0a 0x2dc2 0x2d85 0x3772 0x3337 0x2f14 0x2dc9 0x2d8b 0x3765 0x3349 0x2f21 0x2dce 0x2d8f 0x3763 0x335e 0x2f2c 0x2dd3 0x2d93 0x376a 0x3374 0x2f35 0x2dd8 0x2d98 0x3773 0x3384 0x2f3d 0x2ddd 0x2d9c 0x377f 0x338b 0x2f45 0x2de1 0x2da1 0x3787 0x3391 0x2f4d 0x2de7 0x2da6 0x378c 0x339a 0x2f54 0x2dec 0x2daa 0x378f 0x33a6 0x2f5b 0x2df0 0x2daf 0x3794 0x33ad 0x2f62 0x2df4 0x2db3 0x379f 0x33b2 0x2f69 0x2df8 0x2db7 0x37af 0x33ba 0x2f6f 0x2dfc 0x2dbb 0x37c7 0x33c2 0x2f75 0x2e00 0x2dbf 0x37de 0x33c9 0x2f7a 0x2e04 0x2dc4 0x37e6 0x33d1 0x2f80 0x2e08 0x2dc8 0x37ea 0x33de 0x2f86 0x2e0d 0x2dcd 0x37f0 0x33f1 0x2f8e 0x2e12 0x2dd1 0x3807 0x3403 0x2f95 0x2e17 0x2dd5 0x383b 0x3415 0x2f9d 0x2e1a 0x2dd8 0x386b 0x3422 0x2fa5 0x2e1c 0x2dda 0x3891 0x3427 0x2faa 0x2e1f 0x2ddc 0x38b0 0x3429 0x2fad 0x2e21 0x2ddd 0x38b2 0x342d 0x2fb1 0x2e23 0x2dde 0x3888 0x3439 0x2fb9 0x2e25 0x2de0 0x3873 0x3448 0x2fbf 0x2e27 0x2de1 0x386e 0x3457 0x2fc0 0x2e28 0x2de2 0x3861 0x3449 0x2fc4 0x2e29 0x2de2 0x386f 0x3454 0x2fc7 0x2e2b 0x2de2 0x3869 0x3454 0x2fc8 0x2e2b 0x2de1 0x3868 0x345b 0x2fc9 0x2e2b 0x2de2 0x385f 0x3457 0x2fcf 0x2e2c 0x2de3 0x387c 0x3452 0x2fd1 0x2e30 0x2de6 0x3886 0x346f 0x2fdb 0x2e36 0x2deb 0x38aa 0x3476 0x2ff3 0x2e3f 0x2df0 0x3895 0x349e 0x3007 0x2e4a 0x2dfa 0x38d0 0x34c8 0x3032 0x2e5c 0x2e06 0x38d0 0x34c8 0x3032 0x2e5c 0x2e06 0x38d0 0x34c8 0x3032 0x2e5c 0x2e06>;
						qcom,lut-row-legend = <0x2710 0x2648 0x2580 0x24b8 0x23f0 0x2328 0x2260 0x2198 0x20d0 0x2008 0x1f40 0x1e78 0x1db0 0x1ce8 0x1c20 0x1b58 0x1a90 0x19c8 0x1900 0x1838 0x1770 0x16a8 0x15e0 0x1518 0x1450 0x1388 0x12c0 0x11f8 0x1130 0x1068 0xfa0 0xed8 0xe10 0xd48 0xc80 0xbb8 0xaf0 0xa28 0x960 0x898 0x7d0 0x708 0x640 0x578 0x4b0 0x3e8 0x384 0x320 0x2bc 0x258 0x1f4 0x190 0x12c 0xc8 0x64 0x0>;
					};

					qcom,pc-temp-z2-lut {
						qcom,lut-col-legend = <0x0 0xa 0x19 0x28 0x32>;
						qcom,lut-data = <0x2bb8 0x2632 0x2811 0x296b 0x2a9e 0x280d 0x2a3d 0x2824 0x28fa 0x293e 0x25fe 0x2926 0x282f 0x28bc 0x28c4 0x2606 0x274d 0x282a 0x28ad 0x28ac 0x2620 0x26d2 0x281d 0x2898 0x28a6 0x262f 0x26c3 0x2815 0x288c 0x28a4 0x2631 0x26b5 0x2811 0x2887 0x28a8 0x262c 0x26aa 0x2812 0x2882 0x28ac 0x2625 0x26a2 0x2816 0x2880 0x28ac 0x261b 0x269c 0x2819 0x2884 0x28b5 0x2612 0x2698 0x2813 0x2887 0x28cc 0x2616 0x2696 0x27f3 0x288e 0x28d4 0x2626 0x2699 0x27d7 0x28ae 0x28d3 0x262c 0x26a7 0x27e8 0x28bd 0x28d4 0x2618 0x26b3 0x2814 0x289f 0x28d2 0x25f5 0x26b6 0x282a 0x2883 0x28c7 0x25e5 0x26ba 0x2827 0x288f 0x28d1 0x25e1 0x26c3 0x281d 0x28b2 0x290a 0x25dd 0x26dd 0x2837 0x28e1 0x2937 0x25d6 0x26fd 0x2894 0x2931 0x293f 0x25c9 0x271e 0x28ce 0x296a 0x293f 0x25be 0x2742 0x28b3 0x2939 0x2923 0x25b7 0x2760 0x2883 0x28bd 0x28ee 0x25b1 0x2775 0x2863 0x288b 0x28cc 0x259f 0x2784 0x284c 0x289e 0x28b4 0x2574 0x278c 0x283f 0x28b6 0x28a5 0x2552 0x2793 0x283c 0x28a9 0x28a6 0x2544 0x2797 0x283d 0x2890 0x28af 0x250b 0x2796 0x2845 0x2888 0x28ba 0x24d2 0x2793 0x2859 0x2888 0x28cd 0x24c0 0x2792 0x286f 0x288c 0x28e8 0x24b3 0x2793 0x2885 0x289f 0x290a 0x24aa 0x2795 0x289c 0x28c5 0x2934 0x24a2 0x2799 0x28b4 0x28ea 0x2962 0x249c 0x27a2 0x28ce 0x290a 0x299b 0x2498 0x27aa 0x28df 0x2925 0x29c7 0x249e 0x27b2 0x28e4 0x293c 0x29d8 0x24a4 0x27b7 0x28e7 0x2954 0x29e2 0x24ad 0x27bb 0x28ef 0x2961 0x29ed 0x24b6 0x27c0 0x28fb 0x2964 0x29f9 0x24b5 0x27c2 0x2901 0x2965 0x2a01 0x24a8 0x27b9 0x28fa 0x2971 0x2a03 0x24a4 0x279c 0x28f3 0x2981 0x2a07 0x24aa 0x26ec 0x28f1 0x2987 0x2a1d 0x246c 0x26c6 0x28d6 0x2992 0x2a3b 0x2459 0x26cc 0x28c6 0x29ad 0x2a38 0x2447 0x26dc 0x28df 0x29c9 0x2a6a 0x2449 0x26cd 0x293d 0x29ca 0x2a89 0x243a 0x26ed 0x297e 0x2a06 0x2aa5 0x243e 0x26c3 0x2925 0x29d7 0x2a55 0x2464 0x269c 0x28de 0x298a 0x29c5 0x246e 0x264f 0x28b9 0x2971 0x29af 0x2445 0x25fc 0x289b 0x2927 0x295f 0x241d 0x258f 0x282d 0x28da 0x2904 0x241d 0x258f 0x282d 0x28da 0x2904 0x241d 0x258f 0x282d 0x28da 0x2904>;
						qcom,lut-row-legend = <0x2710 0x2648 0x2580 0x24b8 0x23f0 0x2328 0x2260 0x2198 0x20d0 0x2008 0x1f40 0x1e78 0x1db0 0x1ce8 0x1c20 0x1b58 0x1a90 0x19c8 0x1900 0x1838 0x1770 0x16a8 0x15e0 0x1518 0x1450 0x1388 0x12c0 0x11f8 0x1130 0x1068 0xfa0 0xed8 0xe10 0xd48 0xc80 0xbb8 0xaf0 0xa28 0x960 0x898 0x7d0 0x708 0x640 0x578 0x4b0 0x3e8 0x384 0x320 0x2bc 0x258 0x1f4 0x190 0x12c 0xc8 0x64 0x0>;
					};

					qcom,pc-temp-z3-lut {
						qcom,lut-col-legend = <0x0 0xa 0x19 0x28 0x32>;
						qcom,lut-data = <0x4c45 0x4be7 0x4bad 0x4bb7 0x4b9b 0x4d48 0x4c26 0x4bd0 0x4baa 0x4b96 0x4dd0 0x4c76 0x4bee 0x4bac 0x4b97 0x4de1 0x4cc3 0x4bfa 0x4bb4 0x4b9c 0x4dce 0x4cd9 0x4bff 0x4bb6 0x4b9f 0x4db7 0x4cdc 0x4c00 0x4bb7 0x4ba2 0x4dac 0x4cdd 0x4bfe 0x4bb5 0x4ba2 0x4da7 0x4cdd 0x4bfb 0x4bb0 0x4b9f 0x4da5 0x4ce0 0x4bf8 0x4bac 0x4b9b 0x4da2 0x4ce2 0x4bf6 0x4bac 0x4b99 0x4da0 0x4cd4 0x4bf0 0x4bac 0x4b98 0x4da5 0x4cac 0x4bdf 0x4ba7 0x4b98 0x4db6 0x4c9a 0x4bc8 0x4b9b 0x4b95 0x4dc5 0x4cb6 0x4bce 0x4b96 0x4b91 0x4db4 0x4cd7 0x4bef 0x4ba3 0x4b93 0x4d83 0x4cd1 0x4c01 0x4bb3 0x4b97 0x4d54 0x4cac 0x4bec 0x4bad 0x4b94 0x4d30 0x4c8a 0x4bd0 0x4b9c 0x4b8a 0x4d0e 0x4c6f 0x4bcf 0x4b98 0x4b87 0x4cf1 0x4c5e 0x4be1 0x4ba6 0x4b8e 0x4cd8 0x4c62 0x4bee 0x4bb3 0x4b97 0x4cc6 0x4c75 0x4bef 0x4bb3 0x4b9d 0x4cbc 0x4c87 0x4bef 0x4bae 0x4ba1 0x4cb4 0x4c93 0x4bed 0x4bad 0x4ba2 0x4cac 0x4c9c 0x4bea 0x4bb4 0x4ba0 0x4ca3 0x4c9d 0x4be9 0x4bba 0x4b9e 0x4c97 0x4c9b 0x4bef 0x4bb7 0x4b9c 0x4c8c 0x4c97 0x4bf5 0x4bb2 0x4b9a 0x4c7f 0x4c91 0x4bf6 0x4bae 0x4b98 0x4c6f 0x4c8a 0x4bf4 0x4ba9 0x4b96 0x4c5d 0x4c84 0x4bf2 0x4ba5 0x4b94 0x4c4a 0x4c7f 0x4bef 0x4ba2 0x4b91 0x4c3a 0x4c7a 0x4bea 0x4ba0 0x4b8e 0x4c2b 0x4c73 0x4be7 0x4b9f 0x4b8a 0x4c1e 0x4c6b 0x4be5 0x4b9e 0x4b86 0x4c17 0x4c65 0x4be2 0x4b9e 0x4b84 0x4c1b 0x4c5f 0x4bde 0x4b9e 0x4b84 0x4c23 0x4c5a 0x4bda 0x4b9d 0x4b86 0x4c39 0x4c56 0x4bd7 0x4b9c 0x4b86 0x4c4f 0x4c53 0x4bd6 0x4b97 0x4b83 0x4c46 0x4c4f 0x4bd4 0x4b93 0x4b81 0x4c28 0x4c4a 0x4bd2 0x4b93 0x4b82 0x4c1b 0x4c3f 0x4bd0 0x4b93 0x4b82 0x4c19 0x4bfb 0x4bcc 0x4b93 0x4b83 0x4bac 0x4bb3 0x4bb6 0x4b90 0x4b7f 0x4b91 0x4b94 0x4ba0 0x4b89 0x4b78 0x4b89 0x4b8c 0x4b9e 0x4b80 0x4b70 0x4b8b 0x4b87 0x4b8e 0x4b7e 0x4b70 0x4b74 0x4b76 0x4b83 0x4b7c 0x4b6d 0x4b78 0x4b75 0x4b98 0x4b87 0x4b7c 0x4bab 0x4b91 0x4b9b 0x4b8b 0x4b83 0x4bda 0x4b96 0x4b9d 0x4b8e 0x4b84 0x4bf2 0x4b94 0x4b99 0x4b92 0x4b87 0x4c08 0x4ba0 0x4b9f 0x4b95 0x4b8c 0x4c08 0x4ba0 0x4b9f 0x4b95 0x4b8c 0x4c08 0x4ba0 0x4b9f 0x4b95 0x4b8c>;
						qcom,lut-row-legend = <0x2710 0x2648 0x2580 0x24b8 0x23f0 0x2328 0x2260 0x2198 0x20d0 0x2008 0x1f40 0x1e78 0x1db0 0x1ce8 0x1c20 0x1b58 0x1a90 0x19c8 0x1900 0x1838 0x1770 0x16a8 0x15e0 0x1518 0x1450 0x1388 0x12c0 0x11f8 0x1130 0x1068 0xfa0 0xed8 0xe10 0xd48 0xc80 0xbb8 0xaf0 0xa28 0x960 0x898 0x7d0 0x708 0x640 0x578 0x4b0 0x3e8 0x384 0x320 0x2bc 0x258 0x1f4 0x190 0x12c 0xc8 0x64 0x0>;
					};

					qcom,pc-temp-z4-lut {
						qcom,lut-col-legend = <0x0 0xa 0x19 0x28 0x32>;
						qcom,lut-data = <0x4001 0x3c8d 0x3a72 0x3978 0x397b 0x40ed 0x3c83 0x3a6f 0x39c6 0x39b9 0x40da 0x3c60 0x3a4a 0x39d2 0x39c2 0x4086 0x3c0a 0x3a21 0x39c0 0x39b5 0x4000 0x3ba1 0x39fb 0x39a7 0x399e 0x3f71 0x3b4a 0x39dc 0x3990 0x3986 0x3ef7 0x3b02 0x39c2 0x3981 0x3976 0x3e89 0x3acb 0x39ac 0x3976 0x396c 0x3e16 0x3aa0 0x39a0 0x3970 0x3966 0x3d82 0x3a79 0x399a 0x396d 0x3961 0x3cf4 0x3a50 0x3998 0x396a 0x395d 0x3cc5 0x3a2f 0x3998 0x3965 0x3959 0x3cdb 0x3a29 0x3999 0x395f 0x3951 0x3cf0 0x3a35 0x399d 0x3961 0x394e 0x3cc2 0x3a3c 0x39a2 0x3970 0x395b 0x3c4c 0x3a29 0x39a0 0x397b 0x3968 0x3beb 0x39fe 0x398c 0x396b 0x395e 0x3bb2 0x39dd 0x3979 0x394d 0x3947 0x3b8d 0x39c9 0x3978 0x394f 0x3946 0x3b7e 0x39bd 0x3982 0x3988 0x3974 0x3b75 0x39bc 0x3996 0x39ba 0x39a6 0x3b71 0x39bf 0x39ca 0x39be 0x39ab 0x3b75 0x39c9 0x39fe 0x39b9 0x399f 0x3b7b 0x39fa 0x39fe 0x39ae 0x3991 0x3b80 0x3a38 0x39df 0x3993 0x3982 0x3b85 0x3a46 0x39bf 0x397d 0x3975 0x3b8c 0x3a43 0x39a7 0x3973 0x396c 0x3b92 0x3a3e 0x3994 0x396e 0x3965 0x3b9e 0x3a2f 0x3989 0x3969 0x395f 0x3bab 0x3a18 0x3982 0x3965 0x395a 0x3bb3 0x3a05 0x397d 0x3962 0x3955 0x3bba 0x39f5 0x397b 0x395e 0x3951 0x3bbe 0x39e5 0x397a 0x395a 0x394e 0x3bbc 0x39d6 0x3979 0x395a 0x394d 0x3bb5 0x39c8 0x3979 0x395c 0x3950 0x3ba1 0x39ba 0x3978 0x395e 0x3955 0x3b72 0x39ac 0x3976 0x3961 0x395b 0x3b43 0x39a1 0x3973 0x3963 0x3961 0x3afc 0x399e 0x3970 0x3963 0x3963 0x3abc 0x399c 0x396d 0x3963 0x3960 0x3ab4 0x3999 0x396a 0x3962 0x395d 0x3abb 0x3994 0x3967 0x3960 0x395c 0x3ab9 0x3995 0x3962 0x395d 0x395b 0x3aa3 0x39d0 0x395a 0x3959 0x3958 0x3abd 0x39eb 0x3957 0x394b 0x394c 0x3ac6 0x39f6 0x3953 0x3935 0x3934 0x3acb 0x39f8 0x394d 0x3931 0x392d 0x3ac3 0x39fa 0x3959 0x3929 0x3920 0x3ad0 0x3a03 0x3961 0x3925 0x391e 0x3ac0 0x39ff 0x394e 0x392e 0x392c 0x3a9b 0x39f7 0x3956 0x3935 0x3930 0x3a8e 0x39fe 0x3959 0x3936 0x3935 0x3a94 0x3a0e 0x3963 0x3937 0x3936 0x3aa9 0x3a1d 0x3967 0x393a 0x3936 0x3aa9 0x3a1d 0x3967 0x393a 0x3936 0x3aa9 0x3a1d 0x3967 0x393a 0x3936>;
						qcom,lut-row-legend = <0x2710 0x2648 0x2580 0x24b8 0x23f0 0x2328 0x2260 0x2198 0x20d0 0x2008 0x1f40 0x1e78 0x1db0 0x1ce8 0x1c20 0x1b58 0x1a90 0x19c8 0x1900 0x1838 0x1770 0x16a8 0x15e0 0x1518 0x1450 0x1388 0x12c0 0x11f8 0x1130 0x1068 0xfa0 0xed8 0xe10 0xd48 0xc80 0xbb8 0xaf0 0xa28 0x960 0x898 0x7d0 0x708 0x640 0x578 0x4b0 0x3e8 0x384 0x320 0x2bc 0x258 0x1f4 0x190 0x12c 0xc8 0x64 0x0>;
					};

					qcom,pc-temp-z5-lut {
						qcom,lut-col-legend = <0x0 0xa 0x19 0x28 0x32>;
						qcom,lut-data = <0x2b3c 0x2daa 0x3498 0x4a8d 0x45cc 0x2ef0 0x3052 0x39fb 0x4721 0x484e 0x3117 0x343d 0x3f9f 0x4802 0x4a61 0x31df 0x385f 0x430e 0x4b83 0x4d9f 0x326a 0x3a69 0x44ec 0x4e02 0x5124 0x32f3 0x3bab 0x4673 0x5049 0x55e1 0x33c6 0x3ce5 0x4810 0x514c 0x5936 0x34d0 0x3e95 0x49be 0x511b 0x5a23 0x35db 0x4119 0x4b35 0x5160 0x5a1d 0x36fa 0x4312 0x4c4c 0x5327 0x5b6b 0x3859 0x42b6 0x4bad 0x5424 0x5e2c 0x3a2d 0x3f5c 0x45e6 0x5167 0x6138 0x3c44 0x3ed3 0x3ee4 0x49ed 0x6100 0x3d63 0x47a6 0x4250 0x472f 0x5e7d 0x3d9a 0x506d 0x5049 0x50b3 0x5f98 0x3db5 0x5016 0x57f1 0x5c40 0x639a 0x3dda 0x4c6d 0x532f 0x5d14 0x64bc 0x3dd6 0x4a75 0x4bb9 0x59b9 0x646c 0x3d86 0x49e6 0x55e6 0x5b90 0x6454 0x3cdc 0x49b6 0x76e4 0x6b24 0x646b 0x3bcd 0x5034 0x875d 0x7705 0x6492 0x3ad1 0x649b 0x78a4 0x6a60 0x5e9c 0x3a04 0x7968 0x6282 0x5014 0x511e 0x3939 0x8c1a 0x56c4 0x4873 0x4bc7 0x3846 0x9a39 0x4fd8 0x5026 0x4d8e 0x3716 0x9aa6 0x4dfb 0x5780 0x5074 0x35e9 0x91df 0x53c1 0x5aa0 0x53ba 0x34ed 0x87db 0x5d83 0x5d20 0x57f1 0x33ea 0x7eb5 0x65eb 0x5e8b 0x5cc6 0x32dd 0x764e 0x6eb9 0x601d 0x628a 0x31ca 0x720c 0x75c6 0x61b9 0x67fc 0x30bf 0x6fd5 0x79eb 0x63f1 0x6c9c 0x2ffa 0x6e15 0x7d26 0x6810 0x7085 0x2f5e 0x6c28 0x8068 0x6dc5 0x7165 0x2ed6 0x6a83 0x83d1 0x7653 0x6fdc 0x2e78 0x6a47 0x8529 0x7b5b 0x6e81 0x2ea9 0x6b32 0x8003 0x7adf 0x6f61 0x2f11 0x6ca0 0x7890 0x796f 0x710e 0x303e 0x6e9b 0x7749 0x7672 0x709c 0x317f 0x7119 0x77a9 0x6cad 0x6a94 0x3162 0x71bd 0x77df 0x65cc 0x65f5 0x300b 0x6c45 0x7771 0x66c4 0x66af 0x2fb0 0x60cd 0x7669 0x680b 0x6789 0x3015 0x4018 0x70b0 0x6813 0x6600 0x2ca4 0x3328 0x596b 0x6764 0x62b7 0x2bbe 0x3022 0x477d 0x6688 0x6215 0x2b68 0x2f70 0x4725 0x57da 0x5967 0x2b6c 0x2f09 0x3dd8 0x58e5 0x64be 0x2ab7 0x2db9 0x398d 0x5bd2 0x6460 0x2ae0 0x2ded 0x457f 0x6bcd 0x75c0 0x2cb0 0x2ff3 0x438f 0x6311 0x7110 0x2d80 0x2fa5 0x439f 0x6129 0x668d 0x2d89 0x2ebe 0x3ec3 0x61e3 0x62ca 0x2d50 0x2e6c 0x3eb4 0x5b72 0x6005 0x2d50 0x2e6c 0x3eb4 0x5b72 0x6005 0x2d50 0x2e6c 0x3eb4 0x5b72 0x6005>;
						qcom,lut-row-legend = <0x2710 0x2648 0x2580 0x24b8 0x23f0 0x2328 0x2260 0x2198 0x20d0 0x2008 0x1f40 0x1e78 0x1db0 0x1ce8 0x1c20 0x1b58 0x1a90 0x19c8 0x1900 0x1838 0x1770 0x16a8 0x15e0 0x1518 0x1450 0x1388 0x12c0 0x11f8 0x1130 0x1068 0xfa0 0xed8 0xe10 0xd48 0xc80 0xbb8 0xaf0 0xa28 0x960 0x898 0x7d0 0x708 0x640 0x578 0x4b0 0x3e8 0x384 0x320 0x2bc 0x258 0x1f4 0x190 0x12c 0xc8 0x64 0x0>;
					};

					qcom,pc-temp-z6-lut {
						qcom,lut-col-legend = <0x0 0xa 0x19 0x28 0x32>;
						qcom,lut-data = <0x409a 0x3c2e 0x39dd 0x392f 0x3913 0x416d 0x3c48 0x39ee 0x394b 0x392d 0x419b 0x3c57 0x39ee 0x3952 0x3933 0x4181 0x3c50 0x39e4 0x394f 0x3931 0x413b 0x3c33 0x39d5 0x3947 0x392a 0x40e4 0x3c0c 0x39c7 0x393d 0x3921 0x409c 0x3be5 0x39bb 0x3935 0x391b 0x4062 0x3bcb 0x39b0 0x392e 0x3915 0x4027 0x3bb9 0x39aa 0x392a 0x3910 0x3fe0 0x3ba7 0x39a7 0x3929 0x390e 0x3f9a 0x3b8a 0x39a3 0x3928 0x390c 0x3f73 0x3b64 0x399a 0x3924 0x390b 0x3f65 0x3b56 0x398e 0x391c 0x3906 0x3f55 0x3b62 0x3992 0x3919 0x3903 0x3f1e 0x3b70 0x39a4 0x3927 0x390a 0x3ec0 0x3b64 0x39ac 0x3933 0x3912 0x3e70 0x3b3f 0x3999 0x392a 0x390c 0x3e3a 0x3b22 0x3982 0x3915 0x38fe 0x3e0f 0x3b10 0x3982 0x3914 0x38fc 0x3df2 0x3b06 0x3991 0x3936 0x3915 0x3ddc 0x3b09 0x39a5 0x3953 0x3930 0x3dd2 0x3b19 0x39c1 0x3956 0x3934 0x3dd2 0x3b2e 0x39d7 0x3953 0x3934 0x3dd7 0x3b4e 0x39d6 0x394f 0x3932 0x3ddc 0x3b6d 0x39c9 0x3948 0x392b 0x3de1 0x3b75 0x39be 0x3942 0x3924 0x3de6 0x3b75 0x39b8 0x393d 0x391f 0x3dea 0x3b74 0x39b4 0x3938 0x391c 0x3dee 0x3b6e 0x39b1 0x3935 0x3919 0x3df0 0x3b64 0x39ae 0x3931 0x3916 0x3df0 0x3b5c 0x39ab 0x392e 0x3913 0x3df0 0x3b54 0x39a9 0x392b 0x3910 0x3def 0x3b4c 0x39a8 0x3928 0x390d 0x3ded 0x3b46 0x39a7 0x3928 0x390c 0x3deb 0x3b40 0x39a7 0x3929 0x390c 0x3deb 0x3b3c 0x39a6 0x392a 0x390c 0x3ded 0x3b38 0x39a4 0x392c 0x390f 0x3def 0x3b35 0x39a2 0x392d 0x3913 0x3def 0x3b35 0x39a0 0x392d 0x3914 0x3dee 0x3b36 0x399f 0x392a 0x3912 0x3deb 0x3b36 0x399e 0x3928 0x3910 0x3de2 0x3b35 0x399d 0x3927 0x3910 0x3dd8 0x3b34 0x399b 0x3927 0x390f 0x3dcd 0x3b2c 0x3997 0x3926 0x390f 0x3da1 0x3b16 0x398b 0x391d 0x3908 0x3d94 0x3b10 0x397f 0x3911 0x38f9 0x3d93 0x3b0a 0x397c 0x390a 0x38f2 0x3d8f 0x3b0c 0x3979 0x3906 0x38ec 0x3d8d 0x3b07 0x3977 0x3903 0x38ea 0x3d95 0x3b0c 0x397c 0x390d 0x38f8 0x3da1 0x3b20 0x3983 0x3914 0x38ff 0x3dbd 0x3b30 0x398c 0x3918 0x3902 0x3de0 0x3b45 0x3993 0x391d 0x3906 0x3e15 0x3b6d 0x39a2 0x3924 0x390d 0x3e15 0x3b6d 0x39a2 0x3924 0x390d 0x3e15 0x3b6d 0x39a2 0x3924 0x390d>;
						qcom,lut-row-legend = <0x2710 0x2648 0x2580 0x24b8 0x23f0 0x2328 0x2260 0x2198 0x20d0 0x2008 0x1f40 0x1e78 0x1db0 0x1ce8 0x1c20 0x1b58 0x1a90 0x19c8 0x1900 0x1838 0x1770 0x16a8 0x15e0 0x1518 0x1450 0x1388 0x12c0 0x11f8 0x1130 0x1068 0xfa0 0xed8 0xe10 0xd48 0xc80 0xbb8 0xaf0 0xa28 0x960 0x898 0x7d0 0x708 0x640 0x578 0x4b0 0x3e8 0x384 0x320 0x2bc 0x258 0x1f4 0x190 0x12c 0xc8 0x64 0x0>;
					};
				};
			};
		};
	};

	fragment@2 {
		target = <0xffffffff>;

		__overlay__ {

			msm_gpio_104 {
				phandle = <0x1>;

				config {
					bias-disable;
					drive-strength = <0x2>;
					output-low;
					pins = "gpio104";
				};

				mux {
					function = "gpio";
					pins = "gpio104";
				};
			};

			msm_gpio_104_output_high {
				phandle = <0x2>;

				config {
					bias-disable;
					drive-strength = <0x2>;
					output-high;
					pins = "gpio104";
				};

				mux {
					function = "gpio";
					pins = "gpio104";
				};
			};

			msm_gpio_65 {
				phandle = <0x4>;

				config {
					bias-disable;
					drive-strength = <0x2>;
					output-low;
					pins = "gpio65";
				};

				mux {
					function = "gpio";
					pins = "gpio65";
				};
			};

			msm_gpio_65_output_high {
				phandle = <0x5>;

				config {
					bias-disable;
					drive-strength = <0x2>;
					output-high;
					pins = "gpio65";
				};

				mux {
					function = "gpio";
					pins = "gpio65";
				};
			};

			msm_gpio_83 {
				phandle = <0x3>;

				config {
					bias-pull-down;
					drive-strength = <0x2>;
					pins = "gpio83";
				};

				mux {
					function = "gpio";
					pins = "gpio83";
				};
			};
		};
	};

	fragment@20 {
		target = <0xffffffff>;

		__overlay__ {
			status = "ok";

			qcom,smb1355@8 {
				#address-cells = <0x1>;
				#interrupt-cells = <0x3>;
				#size-cells = <0x0>;
				compatible = "qcom,i2c-pmic";
				interrupt-controller;
				interrupt-parent = <0xffffffff>;
				interrupt_names = "smb1355_0";
				interrupts = <0x0 0xd1 0x0 0x8>;
				phandle = <0x1e>;
				qcom,periph-map = <0x10 0x12 0x13 0x16>;
				reg = <0x8>;
				status = "disabled";

				qcom,smb1355-charger@1000 {
					#address-cells = <0x1>;
					#size-cells = <0x1>;
					compatible = "qcom,smb1355";
					interrupt-parent = <0x1e>;
					phandle = <0x29>;
					reg = <0x1000>;
					status = "disabled";

					qcom,chgr-misc@1600 {
						interrupt-names = "wdog-bark", "temperature-change";
						interrupts = <0x16 0x1 0x1 0x16 0x6 0x1>;
						reg = <0x1600>;
					};

					qcom,chgr@1000 {
						interrupt-names = "chg-state-change";
						interrupts = <0x10 0x1 0x1>;
						reg = <0x1000>;
					};
				};
			};

			qcom,smb1355@c {
				#address-cells = <0x1>;
				#interrupt-cells = <0x3>;
				#size-cells = <0x0>;
				compatible = "qcom,i2c-pmic";
				interrupt-controller;
				interrupt-parent = <0xffffffff>;
				interrupt_names = "smb1355";
				interrupts = <0x2 0xc5 0x0 0x8>;
				phandle = <0x1d>;
				pinctrl-0 = <0x1c>;
				pinctrl-names = "default";
				qcom,periph-map = <0x10 0x12 0x13 0x16>;
				reg = <0xc>;
				status = "ok";

				qcom,smb1355-charger@1000 {
					#address-cells = <0x1>;
					#size-cells = <0x1>;
					compatible = "qcom,smb1355";
					interrupt-parent = <0x1d>;
					phandle = <0x28>;
					qcom,hw-die-temp-mitigation;
					qcom,parallel-mode = <0x1>;
					reg = <0x1000>;
					status = "ok";

					qcom,chgr-misc@1600 {
						interrupt-names = "wdog-bark", "temperature-change";
						interrupts = <0x16 0x1 0x1 0x16 0x6 0x1>;
						reg = <0x1600>;
					};

					qcom,chgr@1000 {
						interrupt-names = "chg-state-change";
						interrupts = <0x10 0x1 0x1>;
						reg = <0x1000>;
					};
				};
			};
		};
	};

	fragment@21 {
		target = <0xffffffff>;

		__overlay__ {
			qcom,bolero-version = <0x5>;
			qcom,num-macros = <0x3>;

			bolero-clk-rsc-mngr {
				clock-names = "tx_core_clk", "tx_npl_clk", "rx_core_clk", "rx_npl_clk", "va_core_clk", "va_npl_clk";
				clocks = <0x2a 0x0 0x2b 0x0 0x2c 0x0 0x2d 0x0 0x2e 0x0 0x2f 0x0>;
				compatible = "qcom,bolero-clk-rsc-mngr";
				qcom,fs-gen-sequence = <0x3000 0x1 0x1 0x3004 0x3 0x3 0x3004 0x3 0x1 0x3080 0x2 0x2>;
				qcom,rx_mclk_mode_muxsel = <0xa5640d8>;
				qcom,va_mclk_mode_muxsel = <0xa7a0000>;
			};

			rx-macro@a600000 {
				clock-names = "rx_core_clk", "rx_npl_clk";
				clocks = <0x2c 0x0 0x2d 0x0>;
				compatible = "qcom,rx-macro";
				phandle = <0x38>;
				qcom,default-clk-id = <0x0>;
				qcom,rx-bcl-pmic-params = [00 04 3e];
				qcom,rx-swr-gpios = <0xffffffff>;
				qcom,rx_mclk_mode_muxsel = <0xa5640d8>;
				reg = <0xa600000 0x0>;

				rx_swr_master {
					#address-cells = <0x2>;
					#size-cells = <0x0>;
					clock-names = "lpass_audio_hw_vote";
					clocks = <0xffffffff 0x0>;
					compatible = "qcom,swr-mstr";
					interrupt-names = "swr_master_irq";
					interrupts = <0x0 0x129 0x4>;
					phandle = <0x39>;
					qcom,disable-div2-clk-switch = <0x1>;
					qcom,mipi-sdw-block-packing-mode = <0x1>;
					qcom,swr-clock-stop-mode0 = <0x1>;
					qcom,swr-master-version = <0x1060000>;
					qcom,swr-num-dev = <0x1>;
					qcom,swr-num-ports = <0x5>;
					qcom,swr-port-mapping = <0x1 0xe 0x1 0x1 0xf 0x2 0x2 0x12 0x1 0x3 0x10 0x1 0x3 0x11 0x2 0x4 0x13 0x1 0x5 0x14 0x1 0x5 0x15 0x2>;
					qcom,swr_master_id = <0x2>;
					qcom,swrm-hctl-reg = <0xa6a9098>;
					swrm-io-base = <0xa610000 0x0>;

					wcd937x-rx-slave {
						compatible = "qcom,wcd937x-slave";
						phandle = <0x31>;
						reg = <0xa 0x1170224>;
					};
				};
			};

			tx-macro@a620000 {
				clock-names = "tx_core_clk", "tx_npl_clk";
				clocks = <0x2a 0x0 0x2b 0x0>;
				compatible = "qcom,tx-macro";
				phandle = <0x37>;
				qcom,is-used-swr-gpio = <0x0>;
				qcom,tx-dmic-sample-rate = <0x249f00>;
				reg = <0xa620000 0x0>;
			};

			va-macro@a730000 {
				clock-names = "lpass_audio_hw_vote";
				clocks = <0xffffffff 0x0>;
				compatible = "qcom,va-macro";
				phandle = <0x3a>;
				qcom,default-clk-id = <0x0>;
				qcom,is-used-swr-gpio = <0x1>;
				qcom,va-clk-mux-select = <0x1>;
				qcom,va-dmic-sample-rate = <0x927c0>;
				qcom,va-island-mode-muxsel = <0xa7a0000>;
				qcom,va-swr-gpios = <0xffffffff>;
				reg = <0xa730000 0x0>;

				va_swr_master {
					#address-cells = <0x2>;
					#size-cells = <0x0>;
					clock-names = "lpass_audio_hw_vote";
					clocks = <0xffffffff 0x0>;
					compatible = "qcom,swr-mstr";
					interrupt-names = "swr_master_irq", "swr_wake_irq";
					interrupts = <0x0 0x128 0x4 0x0 0x4f 0x4>;
					phandle = <0x3b>;
					qcom,is-always-on = <0x1>;
					qcom,mipi-sdw-block-packing-mode = <0x1>;
					qcom,swr-clock-stop-mode0 = <0x1>;
					qcom,swr-master-version = <0x1060000>;
					qcom,swr-mstr-irq-wakeup-capable = <0x1>;
					qcom,swr-num-dev = <0x1>;
					qcom,swr-num-ports = <0x3>;
					qcom,swr-port-mapping = <0x1 0x2e 0x1 0x1 0x2f 0x2 0x1 0x30 0x4 0x1 0x31 0x8 0x2 0x32 0x1 0x2 0x33 0x2 0x2 0x34 0x4 0x2 0x35 0x8 0x3 0x36 0x1 0x3 0x37 0x2 0x3 0x38 0x4 0x3 0x39 0x8>;
					qcom,swr-wakeup-required = <0x1>;
					qcom,swr_master_id = <0x3>;
					qcom,swrm-hctl-reg = <0xa7ec100>;
					swrm-io-base = <0xa740000 0x0>;

					wcd937x-tx-slave {
						compatible = "qcom,wcd937x-slave";
						phandle = <0x32>;
						reg = <0xa 0x1170223>;
					};
				};
			};

			wcd937x-codec {
				cdc-vdd-buck-supply = <0xffffffff>;
				cdc-vdd-rxtx-supply = <0xffffffff>;
				cdc-vddpx-supply = <0xffffffff>;
				compatible = "qcom,wcd937x-codec";
				phandle = <0x33>;
				qcom,cdc-micbias1-mv = <0xa8c>;
				qcom,cdc-micbias2-mv = <0xa8c>;
				qcom,cdc-micbias3-mv = <0xa8c>;
				qcom,cdc-on-demand-supplies = "cdc-vdd-buck";
				qcom,cdc-static-supplies = "cdc-vdd-rxtx", "cdc-vddpx";
				qcom,cdc-vdd-buck-current = <0x9eb10>;
				qcom,cdc-vdd-buck-voltage = <0x1b7740 0x1b7740>;
				qcom,cdc-vdd-rxtx-current = <0x2710>;
				qcom,cdc-vdd-rxtx-voltage = <0x1b7740 0x1b7740>;
				qcom,cdc-vddpx-current = <0x4e20>;
				qcom,cdc-vddpx-voltage = <0x1b7740 0x1b7740>;
				qcom,rx-slave = <0x31>;
				qcom,rx_swr_ch_map = <0x0 0xe 0x1 0x0 0xe 0x0 0xf 0x2 0x0 0xf 0x1 0x12 0x1 0x0 0x12 0x2 0x10 0x1 0x0 0x10 0x2 0x11 0x2 0x0 0x11 0x3 0x13 0x1 0x0 0x13 0x4 0x14 0x1 0x0 0x14 0x4 0x15 0x2 0x0 0x15>;
				qcom,split-codec = <0x1>;
				qcom,swr-tx-port-params = <0x1 0x0 0x0 0x1 0x1 0x0 0x1 0x0 0x0 0x1 0x1 0x0 0x1 0x0 0x1 0x0 0x0 0x1 0x2 0x0 0x1 0x0 0x2 0x0 0x1 0x0 0x1 0x0 0x1 0x0 0x1 0x0>;
				qcom,tx-slave = <0x32>;
				qcom,tx_swr_ch_map = <0x0 0x1e 0x1 0x493e00 0x2e 0x1 0x1f 0x1 0x493e00 0x32 0x1 0x20 0x2 0x493e00 0x33 0x2 0x22 0x1 0x0 0x31 0x2 0x23 0x2 0x0 0x32 0x2 0x1d 0x4 0x493e00 0x33 0x3 0x24 0x1 0x0 0x34 0x3 0x25 0x2 0x0 0x35 0x3 0x26 0x4 0x0 0x36 0x3 0x27 0x8 0x0 0x37>;
				qcom,wcd-rst-gpio-node = <0x30>;
			};
		};
	};

	fragment@22 {
		target = <0xffffffff>;

		__overlay__ {

			pri_mi2s_pinctrl {
				#gpio-cells = <0x0>;
				compatible = "qcom,msm-cdc-pinctrl";
				phandle = <0x3d>;
				pinctrl-0 = <0xffffffff 0xffffffff 0xffffffff 0xffffffff>;
				pinctrl-1 = <0xffffffff 0xffffffff 0xffffffff 0xffffffff>;
				pinctrl-names = "aud_active", "aud_sleep";
				qcom,lpi-gpios;
			};

			sec_mi2s_pinctrl {
				#gpio-cells = <0x0>;
				compatible = "qcom,msm-cdc-pinctrl";
				phandle = <0x3e>;
				pinctrl-0 = <0xffffffff 0xffffffff 0xffffffff 0xffffffff>;
				pinctrl-1 = <0xffffffff 0xffffffff 0xffffffff 0xffffffff>;
				pinctrl-names = "aud_active", "aud_sleep";
				qcom,lpi-gpios;
			};

			sound {
				asoc-codec = <0xffffffff 0xffffffff 0x33>;
				asoc-codec-names = "msm-stub-codec.1", "bolero-codec", "wcd937x_codec";
				nvmem-cell-names = "adsp_variant";
				nvmem-cells = <0xffffffff>;
				phandle = <0x3c>;
				qcom,audio-routing = "AMIC1", "Analog Mic1", "AMIC1", "MIC BIAS1", "AMIC2", "Analog Mic2", "AMIC2", "MIC BIAS2", "AMIC3", "Analog Mic3", "AMIC3", "MIC BIAS3", "TX DMIC0", "Digital Mic0", "TX DMIC0", "MIC BIAS1", "TX DMIC1", "Digital Mic1", "TX DMIC1", "MIC BIAS1", "TX DMIC2", "Digital Mic2", "TX DMIC2", "MIC BIAS3", "TX DMIC3", "Digital Mic3", "TX DMIC3", "MIC BIAS3", "IN1_HPHL", "HPHL_OUT", "IN2_HPHR", "HPHR_OUT", "IN3_AUX", "AUX_OUT", "RX_TX DEC0_INP", "TX DEC0 MUX", "RX_TX DEC1_INP", "TX DEC1 MUX", "RX_TX DEC2_INP", "TX DEC2 MUX", "RX_TX DEC3_INP", "TX DEC3 MUX", "TX SWR_INPUT", "WCD_TX_OUTPUT", "VA SWR_INPUT", "VA_SWR_CLK", "VA SWR_INPUT", "WCD_TX_OUTPUT", "TX_AIF1 CAP", "VA_SWR_CLK", "TX_AIF2 CAP", "VA_SWR_CLK", "TX_AIF3 CAP", "VA_SWR_CLK";
				qcom,cdc-dmic01-gpios = <0xffffffff>;
				qcom,cdc-dmic23-gpios = <0xffffffff>;
				qcom,model = "bengal-idp-snd-card";
				qcom,msm-mbhc-gnd-swh = <0x0>;
				qcom,msm-mbhc-hphl-swh = <0x0>;
				qcom,msm-mbhc-usbc-audio-supported = <0x1>;
				qcom,msm-mi2s-master = <0x1 0x1 0x1 0x1>;
				qcom,msm_audio_ssr_devs = <0xffffffff 0xffffffff 0xffffffff>;
				qcom,rxtx-bolero-codec = <0x1>;
				qcom,va-bolero-codec = <0x1>;
				qcom,wcn-btfm = <0x1>;
				qcom,wsa-aux-dev-prefix = "SpkrMono";
				qcom,wsa-max-devs = <0x0>;
				si,sia81xx-aux-devs = <0x34>;
				si,sia81xx-aux-devs-prefix = "SpkrMonoL";
				si,sia81xx-max-num = <0x1>;
			};
		};
	};

	fragment@23 {
		target = <0xffffffff>;

		__overlay__ {

			aw87xxx_pa_59@59 {
				aw-rx-port-id = <0xb032>;
				compatible = "awinic,aw87xxx_pa";
				dev_index = <0x0>;
				reg = <0x59>;
				reset-gpio = <0xffffffff 0x6a 0x0>;
				status = "okay";
			};

			fs16xx@34 {
				compatible = "foursemi,fs16xx";
				fsm,rst-gpio = <0xffffffff 0x6a 0x0>;
				reg = <0x34>;
				status = "okay";
			};

			sipa_i2c_L@2b {
				compatible = "si,sia81xx-i2c";
				phandle = <0x41>;
				reg = <0x2b>;
				si,sipa-dev = <0x34>;
			};

			wsa881x-i2c-codec@44 {
				compatible = "qcom,wsa881x-i2c-codec";
				phandle = <0x40>;
				reg = <0x44>;
				status = "disable";
			};

			wsa881x-i2c-codec@e {
				clock-names = "wsa_mclk";
				clocks = <0x35 0x0>;
				compatible = "qcom,wsa881x-i2c-codec";
				phandle = <0x3f>;
				qcom,wsa-analog-clk-gpio = <0xffffffff>;
				qcom,wsa-analog-reset-gpio = <0x36>;
				qcom,wsa-prefix = "SpkrMono";
				reg = <0xe>;
				status = "disable";
			};
		};
	};

	fragment@24 {
		target = <0xffffffff>;

		__overlay__ {

			msm_cdc_pinctrl@106 {
				#gpio-cells = <0x0>;
				compatible = "qcom,msm-cdc-pinctrl";
				phandle = <0x36>;
				pinctrl-0 = <0xffffffff>;
				pinctrl-1 = <0xffffffff>;
				pinctrl-names = "aud_active", "aud_sleep";
				status = "disable";
			};

			msm_cdc_pinctrl@92 {
				#gpio-cells = <0x0>;
				compatible = "qcom,msm-cdc-pinctrl";
				phandle = <0x30>;
				pinctrl-0 = <0xffffffff>;
				pinctrl-1 = <0xffffffff>;
				pinctrl-names = "aud_active", "aud_sleep";
			};

			rx_core_clk {
				#clock-cells = <0x1>;
				compatible = "qcom,audio-ref-clk";
				phandle = <0x2c>;
				qcom,codec-ext-clk-src = <0x5>;
				qcom,codec-lpass-clk-id = <0x30e>;
				qcom,codec-lpass-ext-clk-freq = <0x1588800>;
			};

			rx_npl_clk {
				#clock-cells = <0x1>;
				compatible = "qcom,audio-ref-clk";
				phandle = <0x2d>;
				qcom,codec-ext-clk-src = <0x6>;
				qcom,codec-lpass-clk-id = <0x30f>;
				qcom,codec-lpass-ext-clk-freq = <0x1588800>;
			};

			si_pa_L {
				channel_num = <0x0>;
				compatible = "si,sia81xx";
				owi_mode = <0x1>;
				phandle = <0x34>;
				si,si_pa_disable_pin = <0x1>;
				si,si_pa_reset = <0xffffffff 0x6a 0x0>;
				si,si_pa_type = "sia81x9";
				timer_task_hdl = <0x0>;
			};

			tx_core_clk {
				#clock-cells = <0x1>;
				compatible = "qcom,audio-ref-clk";
				phandle = <0x2a>;
				qcom,codec-ext-clk-src = <0x7>;
				qcom,codec-lpass-clk-id = <0x30c>;
				qcom,codec-lpass-ext-clk-freq = <0x124f800>;
			};

			tx_npl_clk {
				#clock-cells = <0x1>;
				compatible = "qcom,audio-ref-clk";
				phandle = <0x2b>;
				qcom,codec-ext-clk-src = <0x8>;
				qcom,codec-lpass-clk-id = <0x30d>;
				qcom,codec-lpass-ext-clk-freq = <0x124f800>;
			};

			va_core_clk {
				#clock-cells = <0x1>;
				compatible = "qcom,audio-ref-clk";
				phandle = <0x2e>;
				qcom,codec-ext-clk-src = <0x2>;
				qcom,codec-lpass-clk-id = <0x307>;
				qcom,codec-lpass-ext-clk-freq = <0x124f800>;
			};

			va_npl_clk {
				#clock-cells = <0x1>;
				compatible = "qcom,audio-ref-clk";
				phandle = <0x2f>;
				qcom,codec-ext-clk-src = <0xa>;
				qcom,codec-lpass-clk-id = <0x308>;
				qcom,codec-lpass-ext-clk-freq = <0x124f800>;
			};

			wsa_ana_clk {
				#clock-cells = <0x1>;
				compatible = "qcom,audio-ref-clk";
				phandle = <0x35>;
				qcom,codec-ext-clk-src = <0x3>;
				qcom,codec-lpass-clk-id = <0x301>;
				qcom,codec-lpass-ext-clk-freq = <0x927c00>;
				status = "disable";
			};
		};
	};

	fragment@25 {
		target = <0xffffffff>;

		__overlay__ {
			adsp-fw-bit-values = <0x1>;
			adsp-fw-names = "adsp2";
			nvmem-cell-names = "adsp_variant";
			nvmem-cells = <0xffffffff>;
		};
	};

	fragment@3 {
		target = <0xffffffff>;

		__overlay__ {
			pinctrl-0 = <0xffffffff 0xffffffff 0x6>;

			rf_pa1_therm {
				label = "rf_pa1_therm";
				qcom,hw-settle-time = <0xc8>;
				qcom,pre-scaling = <0x1 0x1>;
				qcom,ratiometric;
				reg = <0x55>;
			};
		};
	};

	fragment@4 {
		target = <0xffffffff>;

		__overlay__ {
			status = "ok";

			rf_pa1_therm {
				io-channels = <0xffffffff 0x55>;
				qcom,hw-settle-time-us = <0xc8>;
				qcom,ratiometric;
				reg = <0x3>;
			};
		};
	};

	fragment@5 {
		target = <0xffffffff>;

		__overlay__ {

			rf-pa1-therm-usr {
				polling-delay = <0x0>;
				polling-delay-passive = <0x0>;
				thermal-governor = "user_space";
				thermal-sensors = <0xffffffff 0x3>;
				wake-capable-sensor;

				trips {

					active-config0 {
						hysteresis = <0x3e8>;
						temperature = <0x1e848>;
						type = "passive";
					};
				};
			};
		};
	};

	fragment@6 {
		target = <0xffffffff>;

		__overlay__ {

			eldo9_pin {

				gpio@c000 {
					bias-disable;
					function = "normal";
					output-high;
					phandle = <0x9>;
					pins = "gpio1";
					power-source = <0x0>;
					qcom,drive-strength = <0x2>;
				};
			};

			key_vol_up {

				key_vol_up_default {
					bias-pull-up;
					function = "normal";
					input-enable;
					phandle = <0x7>;
					pins = "gpio5";
					power-source = <0x0>;
				};
			};

			oled_vci {

				oled_vci_default {
					bias-disable;
					function = "normal";
					input-disable;
					output-high;
					phandle = <0x1f>;
					pins = "gpio9";
					power-source = <0x0>;
					qcom,drive-strength = <0x2>;
				};

				oled_vci_suspend {
					bias-disable;
					function = "normal";
					input-disable;
					output-low;
					phandle = <0x20>;
					pins = "gpio9";
					power-source = <0x0>;
					qcom,drive-strength = <0x2>;
				};
			};

			rf_pa1_therm {

				rf_pa1_therm_default {
					bias-high-impedance;
					phandle = <0x6>;
					pins = "gpio7";
				};
			};

			vib_out_gpio8 {

				vib_out_gpio8_default {
					bias-pull-up;
					function = "normal";
					phandle = <0x8>;
					pins = "gpio8";
					power-source = <0x0>;
				};
			};
		};
	};

	fragment@7 {
		target = <0xffffffff>;

		__overlay__ {

			ant_check {
				ant_check_gpio = <0xffffffff 0x6b 0x0>;
				compatible = "ant_check";
				interrupt-parent = <0xffffffff>;
				pinctrl-0 = <0xffffffff>;
				pinctrl-names = "default";
			};

			ant_check_div {
				ant_check_div_gpio = <0xffffffff 0x19 0x0>;
				compatible = "ant_check_div";
				interrupt-parent = <0xffffffff>;
				pinctrl-0 = <0xffffffff>;
				pinctrl-names = "default";
			};

			gpio_keys {
				compatible = "gpio-keys";
				label = "gpio-keys";
				pinctrl-0 = <0x7>;
				pinctrl-names = "default";

				vol_up {
					debounce-interval = <0xf>;
					gpio-key,wakeup;
					gpios = <0xffffffff 0x5 0x1>;
					label = "volume_up";
					linux,can-disable;
					linux,code = <0x73>;
					linux,input-type = <0x1>;
				};
			};

			vdda_usb_ss_dp_core {
				compatible = "regulator-fixed";
				enable-active-high;
				gpio = <0xffffffff 0x1 0x0>;
				phandle = <0xa>;
				pinctrl-0 = <0x9>;
				pinctrl-names = "default";
				regulator-max-microvolt = <0xd6d80>;
				regulator-min-microvolt = <0xd6d80>;
				regulator-name = "vdd_supply";
			};

			vibrator_gpio {
				compatible = "qcom,qpnp-vibrator-ldo-tz";
				pinctrl-0 = <0x8>;
				pinctrl-names = "default";
				status = "ok";
				vib,en-gpio = <0xffffffff 0x8 0x1>;
			};
		};
	};

	fragment@8 {
		target = <0xffffffff>;

		__overlay__ {
			vdd-supply = <0xa>;
		};
	};

	fragment@9 {
		target = <0xffffffff>;

		__overlay__ {
			pinctrl-0 = <0xffffffff>;
			pinctrl-1 = <0xffffffff>;
			pinctrl-names = "default", "sleep";
			qcom,vdd-current-level = <0x0 0x8b290>;
			qcom,vdd-io-always-on;
			qcom,vdd-io-current-level = <0x0 0x4f588>;
			qcom,vdd-io-lpm-sup;
			qcom,vdd-io-voltage-level = <0x1b7740 0x1b7740>;
			qcom,vdd-voltage-level = <0x2d2a80 0x2d2a80>;
			status = "ok";
			vdd-io-supply = <0xffffffff>;
			vdd-supply = <0xffffffff>;
		};
	};
};
